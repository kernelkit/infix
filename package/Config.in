## package/Config.in
```kconfig
menu "Packages"

comment "Hardware Support"
source "$BR2_EXTERNAL_INFIX_PATH/package/board/Config.in"

comment "Software Packages"
source "$BR2_EXTERNAL_INFIX_PATH/package/bin/Config.in"
source "$BR2_EXTERNAL_INFIX_PATH/package/confd/Config.in"
source "$BR2_EXTERNAL_INFIX_PATH/package/confd-test-mode/Config.in"
source "$BR2_EXTERNAL_INFIX_PATH/package/curios-httpd/Config.in"
source "$BR2_EXTERNAL_INFIX_PATH/package/curios-nftables/Config.in"
source "$BR2_EXTERNAL_INFIX_PATH/package/execd/Config.in"
source "$BR2_EXTERNAL_INFIX_PATH/package/gencert/Config.in"
source "$BR2_EXTERNAL_INFIX_PATH/package/statd/Config.in"
source "$BR2_EXTERNAL_INFIX_PATH/package/factory/Config.in"
source "$BR2_EXTERNAL_INFIX_PATH/package/faux/Config.in"
source "$BR2_EXTERNAL_INFIX_PATH/package/finit/Config.in"
source "$BR2_EXTERNAL_INFIX_PATH/package/greenpak-programmer/Config.in"
source "$BR2_EXTERNAL_INFIX_PATH/package/ifupdown-ng/Config.in"
source "$BR2_EXTERNAL_INFIX_PATH/package/iito/Config.in"
source "$BR2_EXTERNAL_INFIX_PATH/package/k8s-logger/Config.in"
source "$BR2_EXTERNAL_INFIX_PATH/package/keyack/Config.in"
source "$BR2_EXTERNAL_INFIX_PATH/package/klish-plugin-infix/Config.in"
source "$BR2_EXTERNAL_INFIX_PATH/package/klish/Config.in"
source "$BR2_EXTERNAL_INFIX_PATH/package/klish-plugin-sysrepo/Config.in"
source "$BR2_EXTERNAL_INFIX_PATH/package/landing/Config.in"
source "$BR2_EXTERNAL_INFIX_PATH/package/libsrx/Config.in"
source "$BR2_EXTERNAL_INFIX_PATH/package/lowdown/Config.in"
source "$BR2_EXTERNAL_INFIX_PATH/package/mcd/Config.in"
source "$BR2_EXTERNAL_INFIX_PATH/package/mdns-alias/Config.in"
source "$BR2_EXTERNAL_INFIX_PATH/package/netbrowse/Config.in"
source "$BR2_EXTERNAL_INFIX_PATH/package/podman/Config.in"
source "$BR2_EXTERNAL_INFIX_PATH/package/python-libyang/Config.in"
source "$BR2_EXTERNAL_INFIX_PATH/package/python-statd/Config.in"
source "$BR2_EXTERNAL_INFIX_PATH/package/python-yangdoc/Config.in"
source "$BR2_EXTERNAL_INFIX_PATH/package/skeleton-init-finit/Config.in"
source "$BR2_EXTERNAL_INFIX_PATH/package/tetris/Config.in"
source "$BR2_EXTERNAL_INFIX_PATH/package/libyang-cpp/Config.in"
source "$BR2_EXTERNAL_INFIX_PATH/package/sysrepo-cpp/Config.in"
source "$BR2_EXTERNAL_INFIX_PATH/package/rousette/Config.in"
source "$BR2_EXTERNAL_INFIX_PATH/package/nghttp2-asio/Config.in"
source "$BR2_EXTERNAL_INFIX_PATH/package/date-cpp/Config.in"

endmenu
```

## package/Config.in.host
```kconfig
menu "Host utilities"
source "$BR2_EXTERNAL_INFIX_PATH/package/python-libyang/Config.in.host"
endmenu
```

## package/bin/Config.in
```kconfig
config BR2_PACKAGE_BIN
	bool "bin"
	select BR2_PACKAGE_SYSREPO
	select BR2_PACKAGE_LIBITE
	help
	  Misc. tools for CLI and shell users.

	  Includes show (show.py) copy (NACM-aware datastore operations),
	  rpc (YANG RPC execution with NACM enforcement), erase, and files
	  commands.

	  https://github.com/kernelkit/infix
```

## package/board/Config.in
```kconfig
menu "Boards"

source "$BR2_EXTERNAL_INFIX_PATH/package/board/alder-alder/Config.in"
source "$BR2_EXTERNAL_INFIX_PATH/package/board/freescale-imx8mp-evk/Config.in"
source "$BR2_EXTERNAL_INFIX_PATH/package/board/marvell-cn9130-crb/Config.in"
source "$BR2_EXTERNAL_INFIX_PATH/package/board/marvell-espressobin/Config.in"
source "$BR2_EXTERNAL_INFIX_PATH/package/board/microchip-sparx5-pcb135/Config.in"
source "$BR2_EXTERNAL_INFIX_PATH/package/board/styx-dcp-sc-28p/Config.in"

endmenu
```

## package/board/banana-pi-r3/Config.in
```kconfig
config BR2_PACKAGE_BANANA_PI_R3
	bool "Banana Pi R3"
	depends on BR2_aarch64
	select BR2_PACKAGE_FEATURE_WIFI
	select BR2_PACKAGE_LINUX_FIRMWARE
	select BR2_PACKAGE_LINUX_FIRMWARE_MEDIATEK
	select BR2_PACKAGE_LINUX_FIRMWARE_MEDIATEK_MT7986
	select SDCARD_AUX
	help
	  Build Banana PI R3 support
```

## package/board/raspberry-pi-4/Config.in
```kconfig
config BR2_PACKAGE_RASPBERRY_PI_4
	bool "Raspberry Pi 4"
	depends on BR2_aarch64
	select SDCARD_AUX
	select BR2_PACKAGE_FEATURE_WIFI
	select BR2_PACKAGE_BRCMFMAC_SDIO_FIRMWARE_RPI
	select BR2_PACKAGE_BRCMFMAC_SDIO_FIRMWARE_RPI_WIFI

	help
	  Raspberry Pi 4
```

## package/board/styx-dcp-sc-28p/Config.in
```kconfig
config BR2_PACKAGE_STYX_DCP_SC_28P
	bool "Styx DCP-SC-28P"
	depends on BR2_aarch64
	help
	  Styx DCP-SC-28P
```

## package/bootloader-splashscreen/Config.in
```kconfig
config BR2_PACKAGE_BOOTLOADER_SPLASHSCREEN
	bool "bootloader-splashscreen"
	help
	  Install a BMP splash screen image for bootloader.

config BR2_PACKAGE_BOOTLOADER_SPLASHSCREEN_PATH
	string "Path to BMP image"
	default "$(BR2_EXTERNAL_INFIX_PATH)/board/common/uboot/splash.bmp"
	depends on BR2_PACKAGE_BOOTLOADER_SPLASHSCREEN
	help
	  Path to the BMP image file to be used as bootloader splash screen.
	  The image will be installed to output/images/.
```

## package/cligen/Config.in
```kconfig
config BR2_PACKAGE_CLIGEN
	bool "cligen"
	help
	  CLIgen is a Command-Line Interface generator.

	  https://github.com/clicon/cligen
```

## package/clixon/Config.in
```kconfig
config BR2_PACKAGE_CLIXON
	bool "clixon"
	depends on BR2_USE_MMU
	select BR2_PACKAGE_CLIGEN
#	select BR2_PACKAGE_LIBCURL
#	select BR2_PACKAGE_LIBXML2
	help
	  Clixon is a YANG-based configuration manager, with interactive
	  CLI, NETCONF and RESTCONF interfaces, an embedded database and
	  transaction mechanism.

          Clixon has support for RESTCONF over HTTP/2 using NGHTTP2 as
	  well as support for FCGI using NGINX (HTTP/1), or the native
	  support for HTTP/1.

	  If Net-SNMP is enabled, it is possible to also enable the Clixon
	  YANG mapping to SNMP.

	  NOTE: Clixon by itself does not do anything, you need to build an
	        application it can run.  See the example for more info.

	  https://github.com/clicon/clixon

if BR2_PACKAGE_CLIXON

config BR2_PACKAGE_CLIXON_EXAMPLE
	bool "example"
	help
	  Install Clixon YANG + CLI example application.

choice
        prompt "restconf"
        default BR2_PACKAGE_CLIXON_RESTCONF_NATIVE

config BR2_PACKAGE_CLIXON_RESTCONF_NATIVE
	bool "native"
	help
	  Native RESTCONF frontend supports HTTP/1 by default, for
	  HTTP/2 it relies on the nghttp2 library.

config BR2_PACKAGE_CLIXON_RESTCONF_FCGI
	bool "nginx"
	select BR2_PACKAGE_NGINX
	select BR2_PACKAGE_NGINX_HTTP_FASTCGI_MODULE
	select BR2_PACKAGE_LIBFCGI
	help
	  Enable RESTCONF using NGINX fastcgi instead of native.

config BR2_PACKAGE_CLIXON_RESTCONF_NONE
	bool "disabled"
	help
	  Disable RESTCONF frontend completely.

endchoice

config BR2_PACKAGE_CLIXON_HTTP1
	bool "native http/1"
	default y
	depends on BR2_PACKAGE_CLIXON_RESTCONF_NATIVE
	help
	  By default, native HTTP/1 support restconf is enabled.
	  Disabling this leaves nginx fcgi or http/2 options.

config BR2_PACKAGE_CLIXON_HTTP2
	bool "native http/2"
	depends on BR2_PACKAGE_CLIXON_RESTCONF_NATIVE
	select BR2_PACKAGE_NGHTTP2
	help
	  Native RESTCONF over HTTP/2 using NGHTTP2 package.


config BR2_PACKAGE_CLIXON_PUBLISH
	bool "publish"
	help
	  Enable publish of notification streams using SSE and curl.

config BR2_PACKAGE_CLIXON_SNMP
	bool "net-snmp"
	depends on BR2_PACKAGE_NETSNMP
	help
	  Enable mapping of YANG to SNMP.  Uses AgentX interface.

endif
```

## package/confd-test-mode/Config.in
```kconfig
config BR2_PACKAGE_CONFD_TEST_MODE
	bool "confd test mode"
	depends on BR2_PACKAGE_CONFD
	select BR2_PACKAGE_LIBITE
	select BR2_PACKAGE_LIBYANG
	select BR2_PACKAGE_SYSREPO
	select BR2_PACKAGE_LIBSRX
	help
	  A companion plugin to confd providing functionality required to
	  run tests with Infamy, i.e., enable Infix test mode.
```

## package/confd/Config.in
```kconfig
config BR2_PACKAGE_CONFD
	bool "confd"
	select BR2_PACKAGE_JANSSON
	select BR2_PACKAGE_LIBITE
	select BR2_PACKAGE_NETOPEER2
	select BR2_PACKAGE_SYSREPO
	select BR2_PACKAGE_LIBSRX
	help
	  A plugin to sysrepo that provides the core YANG models used to
	  manage an Infix based system.  Configuration can be done using
	  either the on-system CLI or using NETCONF.

	  https://github.com/kernelkit/infix

if BR2_PACKAGE_CONFD

choice
	prompt "Default password crypt"
	default BR2_PACKAGE_CONFD_YESCRYPT
	help
	  When users set $0$cleartext-password as their password confd
	  salts and encrypts the "cleartext-password" with this selected
	  hash algorithm.

	  Infix defaults to yescrypt.

config BR2_PACKAGE_CONFD_MD5CRYPT
	bool "md5crypt"
	help

config BR2_PACKAGE_CONFD_SHA256CRYPT
	bool "sha256crypt"

config BR2_PACKAGE_CONFD_SHA512CRYPT
	bool "sha512crypt"

config BR2_PACKAGE_CONFD_YESCRYPT
	bool "yescrypt"

endchoice

config BR2_PACKAGE_CONFD_DEFAULT_CRYPT
	string
	default "md5crypt"    if BR2_PACKAGE_CONFD_MD5CRYPT
	default "sha256crypt" if BR2_PACKAGE_CONFD_SHA256CRYPT
	default "sha512crypt" if BR2_PACKAGE_CONFD_SHA512CRYPT
	default "yescrypt"    if BR2_PACKAGE_CONFD_YESCRYPT

endif
```

## package/conmon/Config.in
```kconfig
config BR2_PACKAGE_CONMON
	bool "conmon"
	depends on BR2_TOOLCHAIN_HAS_THREADS # libglib2
	depends on BR2_USE_MMU # libglib2
	depends on BR2_USE_WCHAR # libglib2
	depends on !BR2_TOOLCHAIN_USES_UCLIBC # no fexecve
	select BR2_PACKAGE_LIBGLIB2
	help
	  Conmon is an OCI container runtime monitor, commonly used as an
          interface between runc/crun and podman/CRI-O.

	  https://github.com/containers/conmon

comment "conmon needs a glibc or musl toolchain w/ threads, wchar"
	depends on !BR2_USE_WCHAR || !BR2_TOOLCHAIN_HAS_THREADS || \
		BR2_TOOLCHAIN_USES_UCLIBC
	depends on BR2_USE_MMU
```

## package/curios-httpd/Config.in
```kconfig
config BR2_PACKAGE_CURIOS_HTTPD
	bool "curiOS-httpd"
	help
	  Example of how to bundle an OCI archive of curiOS-httpd in
	  /lib/oci for the given target architecture.  OCI archives can
	  also be bundled in post-build.sh, but with packaging all the
	  "source" tarballs are bundled for SDK builds (archiving).

	  https://github.com/kernelkit/curiOS
```

## package/curios-nftables/Config.in
```kconfig
config BR2_PACKAGE_CURIOS_NFTABLES
	bool "curiOS-nftables"
	help
	  Example of how to bundle an OCI archive of curiOS-nftables in
	  /lib/oci for the given target architecture.  OCI archives can
	  also be bundled in post-build.sh, but with packaging all the
	  "source" tarballs are bundled for SDK builds (archiving).

	  https://github.com/kernelkit/curiOS
```

## package/execd/Config.in
```kconfig
config BR2_PACKAGE_EXECD
	bool "execd"
	select BR2_PACKAGE_LIBUEV
	select BR2_PACKAGE_LIBITE
	help
	  Generic job queue executor with retry on route changes.
```

## package/factory/Config.in
```kconfig
config BR2_PACKAGE_FACTORY
	bool "factory-reset"
	help
	  Simple factory reset program/login-shell for instructing the
	  system to factory reset itself, and reboot.

	  The program is made to run as SUID root to be able to tell the
	  system to reboot.  Sufficient care has been taken to make the
	  factory program as secure as possible.  With the worst possible
	  eftect to only be abused to reboot the system.

	  https://github.com/kernelkit/infix
```

## package/faux/Config.in
```kconfig
config BR2_PACKAGE_FAUX
	bool "faux"
	depends on BR2_USE_MMU
	help
	  The library contains a set of auxiliary functions.

	  https://src.libcode.org/pkun/faux/
```

## package/feature-gps/Config.in
```kconfig
config BR2_PACKAGE_FEATURE_GPS
	bool "Feature GPS/GNSS"
	select BR2_PACKAGE_GPSD
	select BR2_PACKAGE_GPSD_MAX_CLIENT
	select BR2_PACKAGE_GPSD_MAX_DEV
	select BR2_PACKAGE_GPSD_SQUELCH
	select BR2_PACKAGE_GPSD_ASHTECH
	select BR2_PACKAGE_GPSD_EARTHMATE
	select BR2_PACKAGE_GPSD_EVERMORE
	select BR2_PACKAGE_GPSD_FURY
	select BR2_PACKAGE_GPSD_FV18
	select BR2_PACKAGE_GPSD_GARMIN
	select BR2_PACKAGE_GPSD_GARMIN_SIMPLE_TXT
	select BR2_PACKAGE_GPSD_GEOSTAR
	select BR2_PACKAGE_GPSD_GPSCLOCK
	select BR2_PACKAGE_GPSD_GREIS
	select BR2_PACKAGE_GPSD_ISYNC
	select BR2_PACKAGE_GPSD_ITRAX
	select BR2_PACKAGE_GPSD_NMEA2000
	select BR2_PACKAGE_GPSD_OCEANSERVER
	select BR2_PACKAGE_GPSD_ONCORE
	select BR2_PACKAGE_GPSD_RTCM104V2
	select BR2_PACKAGE_GPSD_RTCM104V3
	select BR2_PACKAGE_GPSD_SIRF
	select BR2_PACKAGE_GPSD_SKYTRAQ
	select BR2_PACKAGE_GPSD_SUPERSTAR2
	select BR2_PACKAGE_GPSD_TRIMBLE_TSIP
	select BR2_PACKAGE_GPSD_TRIPMATE
	select BR2_PACKAGE_GPSD_TRUE_NORTH
	select BR2_PACKAGE_GPSD_UBX
	help
	  Enables GPS/GNSS support in Infix.  Includes gpsd with all
	  receiver protocol drivers and kernel USB ACM support for
	  common USB GPS receivers.
```

## package/feature-wifi-support/Config.in
```kconfig
config BR2_PACKAGE_FEATURE_WIFI_SUPPORT
	bool "feature-wifi-support"
	select BR2_PACKAGE_WPA_SUPPLICANT
	select BR2_PACKAGE_WPA_SUPPLICANT_WPA3
	select BR2_PACKAGE_WPA_SUPPLICANT_DEBUG_SYSLOG
	select BR2_PACKAGE_WPA_SUPPLICANT_AUTOSCAN
	select BR2_PACKAGE_WPA_SUPPLICANT_CLI
	select BR2_PACKAGE_PYTHON_PYROUTE2
	select BR2_PACKAGE_LINUX_FIRMWARE
	select BR2_PACKAGE_BRCMFMAC_SDIO_FIRMWARE_RPI
	select BR2_PACKAGE_BRCMFMAC_SDIO_FIRMWARE_RPI_WIFI
	select BR2_PACKAGE_LINUX_FIRMWARE_RTL_RTW88
	select BR2_PACKAGE_LINUX_FIRMWARE_RTL_RTW89
	select BR2_PACKAGE_LINUX_FIRMWARE_BRCM_BCM43XX
	select BR2_PACKAGE_LINUX_FIRMWARE_BRCM_BCM4366B1
	select BR2_PACKAGE_LINUX_FIRMWARE_RTL_88XX

help
	  Enables WiFi in Infix. Enables all requried applications and
	  some firmwares and some drivers.
```

## package/feature-wifi/Config.in
```kconfig
config BR2_PACKAGE_FEATURE_WIFI
	bool "Feature Wi-Fi"
	select BR2_PACKAGE_WPA_SUPPLICANT
	select BR2_PACKAGE_WPA_SUPPLICANT_WPA3
	select BR2_PACKAGE_WPA_SUPPLICANT_DEBUG_SYSLOG
	select BR2_PACKAGE_WPA_SUPPLICANT_AUTOSCAN
	select BR2_PACKAGE_WPA_SUPPLICANT_CLI
	select BR2_PACKAGE_WPA_SUPPLICANT_AP_SUPPORT
	select BR2_PACKAGE_WPA_SUPPLICANT_MESH_NETWORKING
	select BR2_PACKAGE_WIRELESS_REGDB
        select BR2_PACKAGE_HOSTAPD
        select BR2_PACKAGE_HOSTAPD_DRIVER_NL80211
        select BR2_PACKAGE_HOSTAPD_WPA3
        select BR2_PACKAGE_HOSTAPD_WPS
        select BR2_PACKAGE_HOSTAPD_WNM
        select BR2_PACKAGE_HOSTAPD_MBO
	select BR2_PACKAGE_IW
	help
	  Enables WiFi in Infix. Enables all requried applications.

config BR2_PACKAGE_FEATURE_WIFI_HWSIM
	bool "Virtual Wi-Fi radios (mac80211_hwsim)"
	depends on BR2_PACKAGE_FEATURE_WIFI
	help
	  Build the mac80211_hwsim virtual radio driver (as a module) for the
	  QEMU test target, to exercise AP, station, and mesh modes without
	  physical WiFi adapters. The module is autoloaded at boot (see the
	  x86_64 /etc/modules-load.d) and frames are bridged between guests by
	  the wifimedium relay.

	  Leave disabled on real hardware; it only provides simulated radios.

config BR2_PACKAGE_FEATURE_WIFI_MEDIATEK
       bool "Mediatek WiFi Devices"
       depends on BR2_PACKAGE_FEATURE_WIFI
       select BR2_PACKAGE_LINUX_FIRMWARE
       select BR2_PACKAGE_LINUX_FIRMWARE_MEDIATEK_MT7601U
       select BR2_PACKAGE_LINUX_FIRMWARE_MEDIATEK_MT7610E
       select BR2_PACKAGE_LINUX_FIRMWARE_MEDIATEK_MT7615
       select BR2_PACKAGE_LINUX_FIRMWARE_MEDIATEK_MT76X2E
       select BR2_PACKAGE_LINUX_FIRMWARE_MEDIATEK_MT7921
       select BR2_PACKAGE_LINUX_FIRMWARE_MEDIATEK_MT7922
       select BR2_PACKAGE_LINUX_FIRMWARE_MEDIATEK_MT7925
       help
         Enables support for various Mediatek WiFi devices.

config BR2_PACKAGE_FEATURE_WIFI_REALTEK
       bool "Realtek WiFi Devices"
       depends on BR2_PACKAGE_FEATURE_WIFI
       select BR2_PACKAGE_LINUX_FIRMWARE
       select BR2_PACKAGE_LINUX_FIRMWARE_RTL_81XX
       select BR2_PACKAGE_LINUX_FIRMWARE_RTL_RTW88
       select BR2_PACKAGE_LINUX_FIRMWARE_RTL_RTW89
        help
          Enables support for RTL81xx, RTW88, and RTW89 WiFi devices.

config BR2_PACKAGE_FEATURE_WIFI_QUALCOMM
       bool "Qualcomm WiFi Devices"
       depends on BR2_PACKAGE_FEATURE_WIFI
       select BR2_PACKAGE_LINUX_FIRMWARE
       select BR2_PACKAGE_LINUX_FIRMWARE_ATHEROS_11K_WCN6855
       help
         Enables support for Qualcomm Atheros ath11k WiFi devices.
```
