## package/ifupdown-ng/Config.in
```kconfig
config BR2_PACKAGE_IFUPDOWN_NG
	bool "ifupdown-ng"
	depends on BR2_USE_MMU # fork()
	depends on BR2_TOOLCHAIN_HEADERS_AT_LEAST_3_4 # iproute2
	depends on BR2_PACKAGE_BUSYBOX_SHOW_OTHERS
	select BR2_PACKAGE_LIBBSD if BR2_TOOLCHAIN_USES_GLIBC
	# runtime for ip binary
	select BR2_PACKAGE_IPROUTE2 if !BR2_PACKAGE_BUSYBOX
	# runtime for run-parts
	select BR2_PACKAGE_DEBIANUTILS if !BR2_PACKAGE_BUSYBOX
	help
	  ifupdown-ng is a network device manager that is largely
	  compatible with Debian ifupdown, BusyBox ifupdown and Cumulus
	  Networks ifupdown2.

	  https://github.com/ifupdown-ng/ifupdown-ng

comment "ifupdown needs a toolchain w/ headers >= 3.4"
	depends on BR2_USE_MMU
	depends on !BR2_TOOLCHAIN_HEADERS_AT_LEAST_3_4
	depends on BR2_PACKAGE_BUSYBOX_SHOW_OTHERS
```

## package/ifupdown2/Config.in
```kconfig
config BR2_PACKAGE_IFUPDOWN2
	bool "ifupdown2"
	select BR2_PACKAGE_IPROUTE2
	select BR2_PACKAGE_PYTHON3 # need, e.g., xml
	select BR2_PACKAGE_PYTHON_MAKO # runtime
	select BR2_PACKAGE_PYTHON_SIX # runtime
	select BR2_PACKAGE_PYTHON_SETUPTOOLS # runtime
	help
	  Second generation high level tools to configure network interfaces.

	  https://github.com/CumulusNetworks/ifupdown2/
```

## package/iito/Config.in
```kconfig
config BR2_PACKAGE_IITO
	bool "iito"
	depends on BR2_PACKAGE_HAS_UDEV
	select BR2_PACKAGE_JANSSON
	select BR2_PACKAGE_LIBEV
	help
	  If Input, Then Output

	  Monitor input sources, and reflect their state on output sinks.

	  https://github.com/kernelkit/iito
```

## package/initviz/Config.in
```kconfig
config BR2_PACKAGE_INITVIZ
	bool "initviz"
	depends on BR2_USE_MMU # fork()
	help
	  InitViz is a performance analysis and visualization tool for the
	  boot process and system services.  It consists of the bootchartd
	  data collection daemon (bootchartd) that runs during boot to
	  capture system activity, and InitViz the host visualization tool.

	  InitViz is a reimplementation and successor to the bootchart2
	  project, offering a more feature-rich solution compared to the
	  bootchartd subset available as a BusyBox applet.

	  To profile the boot process, append the following to the kernel
	  command line:

	      init=/sbin/bootchartd initcall_debug printk.time=y quiet

	  The collected data can be visualized using the host-initviz
	  tool, initviz.py, which is currently not built here.

	  https://github.com/finit-project/InitViz
```

## package/k8s-logger/Config.in
```kconfig
config BR2_PACKAGE_K8S_LOGGER
	bool "k8s-logger"
	depends on BR2_PACKAGE_PODMAN
	depends on BR2_PACKAGE_SYSKLOGD
	select BR2_PACKAGE_LIBITE
	help
	  Reads k8s-file style logs written to a fifo (mkfifo) by by podman
	  and forwards them, line by assembled line, to syslog.

	  Infix requires use of sysklogd to enable the syslogp() API so that
	  k8s-logger also includes the container's main PID.

	  https://github.com/kernelkit/k8s-logger
```

## package/keyack/Config.in
```kconfig
config BR2_PACKAGE_KEYACK
	bool "keyack"
	help
	  Blocks until a specific key is pressed and released. Useful
	  when you want a user to confirm some action by physically
	  pressing a button.

	  https://github.com/kernelkit/infix
```

## package/klinfix/Config.in
```kconfig
config BR2_PACKAGE_KLINFIX
	bool "klinfix"
	select BR2_PACKAGE_KLISH
	select BR2_PACKAGE_KLISH_PLUGIN_SYSREPO
	select BR2_PACKAGE_SYSREPO
	help
	  A plugin to klish with an opinionated config and some
	  command extensions, suitable for systems running Infix.
```

## package/klish-plugin-infix/Config.in
```kconfig
config BR2_PACKAGE_KLISH_PLUGIN_INFIX
	bool "klish-plugin-infix"
	select BR2_PACKAGE_KLISH
	select BR2_PACKAGE_KLISH_PLUGIN_SYSREPO
	select BR2_PACKAGE_SYSREPO
	help
	  A plugin to klish with an opinionated config and some
	  command extensions, suitable for systems running Infix.

if BR2_PACKAGE_KLISH_PLUGIN_INFIX

config BR2_PACKAGE_KLISH_PLUGIN_INFIX_SHELL
	bool "shell command"
	help
	  Include 'shell' command exit to Bash.

endif
```

## package/klish-plugin-sysrepo/Config.in
```kconfig
config BR2_PACKAGE_KLISH_PLUGIN_SYSREPO
	bool "klish-plugin-sysrepo"
	depends on BR2_PACKAGE_KLISH
	depends on BR2_PACKAGE_SYSREPO
	help
	  This plugin allows klish framework to implement Juniper-like
	  interface for configuration. It uses sysrepo project as
	  background for datastores and libyang for yang files parsing
	  and configuration schemes.

	  https://src.libcode.org/pkun/klish-plugin-sysrepo/

config BR2_PACKAGE_KLISH_PLUGIN_SYSREPO_XML
	bool "install xml"
	depends on BR2_PACKAGE_KLISH_PLUGIN_SYSREPO
	default y
	help
	  Install the default XML spec bundled with the project, which
	  exports the 'show' command, and the 'configure' view, etc.

	  If unsure, say Y.
```

## package/klish/Config.in
```kconfig
config BR2_PACKAGE_KLISH
	bool "klish"
	depends on BR2_USE_MMU
	select BR2_PACKAGE_FAUX
	select BR2_PACKAGE_LIBXML2
	help
	  Klish is a framework for implementing a CISCO-like or
	  Juniper-like CLI on a UNIX systems.

	  https://src.libcode.org/pkun/klish/

config BR2_PACKAGE_KLISH_DEFAULT_XML
	bool "install xml"
	depends on BR2_PACKAGE_KLISH
	default y
	help
	  Install a small XML spec containing a definition of an
	  'exit' command. This lets klish work out-of-the-box, even if
	  no other specs are available.

	  If unsure, say Y.
```

## package/landing/Config.in
```kconfig
config BR2_PACKAGE_LANDING
	bool "Landing page (temporary)"
	help
	  Temporary landing page before upcoming webui.

	  https://github.com/kernelkit/infix
```

## package/libsrx/Config.in
```kconfig
config BR2_PACKAGE_LIBSRX
	bool "libsrx"
	select BR2_PACKAGE_SYSREPO
	help
	  Extensions and helper APIs for sysrepo plugins.

	  https://github.com/kernelkit/infix
```

## package/libyang-cpp/Config.in
```kconfig
config BR2_PACKAGE_LIBYANG_CPP
	bool "libyang-cpp"
	depends on BR2_USE_MMU
	select BR2_PACKAGE_LIBYANG
	help
	   Libyang CPP bindings
```

## package/lowdown/Config.in
```kconfig
config BR2_PACKAGE_LOWDOWN
	bool "lowdown"
	help
	  Simple markdown translator, useful for terminals.

	  https://kristaps.bsd.lv/lowdown/
```

## package/lua-resty-core/Config.in
```kconfig
config BR2_PACKAGE_LUA_RESTY_CORE
       bool "lua-resty-core"
       depends on BR2_PACKAGE_HAS_LUAINTERPRETER
	help
		Lua support in nginx
```

## package/lua-resty-lrucache/Config.in
```kconfig
config BR2_PACKAGE_LUA_RESTY_LRUCACHE
       bool "lua-resty-lrucache"
       depends on BR2_PACKAGE_HAS_LUAINTERPRETER
       help
	Implements a simple LRU cache for OpenResty and the ngx_lua module.
```

## package/mcd/Config.in
```kconfig
config BR2_PACKAGE_MCD
	bool "mcd"
	help
	  A bridge helper daemon for sending multicast queries.

	  https://github.com/kernelkit/mcd
```

## package/mdns-alias/Config.in
```kconfig
config BR2_PACKAGE_MDNS_ALIAS
	bool mdns-alias
	select BR2_PACKAGE_AVAHI
	select BR2_PACKAGE_LIBUEV
	help
	  Advertises the initial $(HOSTNAME).local and network.local with Avahi.
```

## package/mdnsd/Config.in
```kconfig
config BR2_PACKAGE_MDNSD
	bool "mdnsd - Embeddable mDNS-SD daemon"
	help
	  Small mDNS-SD daemon for advertising services of an embedded
	  systems.   No NSS integration with GLIBC.

	  Includes the mquery tool, similar to mdns-scan.

	  https://github.com/troglobit/mdnsd/

if BR2_PACKAGE_MDNSD

comment "Services to advertise"

config BR2_PACKAGE_MDNSD_FTP_SERVICE
	bool "FTP service"
	default n

config BR2_PACKAGE_MDNSD_HTTP_SERVICE
	bool "HTTP service"
	default n

config BR2_PACKAGE_MDNSD_IPP_SERVICE
	bool "IPP service"
	default n

config BR2_PACKAGE_MDNSD_PRINTER_SERVICE
	bool "Printer service"
	default n

config BR2_PACKAGE_MDNSD_SSH_SERVICE
	bool "SSH service"
	default y

endif
```

## package/mech/Config.in
```kconfig
config BR2_PACKAGE_MECH
	bool "mech"
	select BR2_PACKAGE_CLIXON
	select BR2_PACKAGE_AUGEAS
	select BR2_PACKAGE_JANSSON
	help
	  Orchestrate an Infix node using any of the front-ends
	  offered by Clixon, e.g. NETCONF, RESTCONF or SNMP.
```

## package/modemd/Config.in
```kconfig
config BR2_PACKAGE_MODEMD
	bool "modemd"
	select BR2_PACKAGE_MODEM_MANAGER
	select BR2_PACKAGE_PYTHON3
	help
	  Daemon which manages modems.
```

## package/net/Config.in
```kconfig
config BR2_PACKAGE_NET
	bool "net"
	select BR2_PACKAGE_LIBITE
	help
	  Handles transitions between network states.
```

## package/netbrowse/Config.in
```kconfig
config BR2_PACKAGE_NETBROWSE
	bool netbrowse
	depends on BR2_PACKAGE_HOST_GO_TARGET_ARCH_SUPPORTS
	help
	  Browse mDNS hosts on your network from https://network.local
```

## package/netd/Config.in
```kconfig
config BR2_PACKAGE_NETD
	bool "netd"
	select BR2_PACKAGE_LIBITE
	select BR2_PACKAGE_LIBCONFUSE
	select BR2_PACKAGE_LIBEV
	help
	  Network route daemon. Manages static routes and RIP routing.
	  Reads configuration from /etc/net.d/*.conf.

	  With FRR: Full routing via gRPC, vtysh, or frr.conf.
	  Without FRR: Standalone Linux backend via rtnetlink.

	  https://github.com/kernelkit/infix

if BR2_PACKAGE_NETD

choice
	prompt "FRR backend"
	default BR2_PACKAGE_NETD_FRR_VTYSH if BR2_PACKAGE_FRR
	default BR2_PACKAGE_NETD_LINUX

config BR2_PACKAGE_NETD_FRR_VTYSH
	bool "FRR vtysh"
	depends on BR2_PACKAGE_FRR
	help
	  Enable FRR integration via vtysh -b.
	  netd generates incremental config diffs and applies
	  them to running FRR daemons via vtysh -b.

	  FRR daemons run as standalone finit services (no watchfrr).
	  Provides static routes and RIP support.

config BR2_PACKAGE_NETD_FRR_CONF
	bool "FRR frr.conf"
	depends on BR2_PACKAGE_FRR
	help
	  Enable FRR integration via frr.conf file generation.
	  netd assembles a single /etc/frr/frr.conf from routing
	  config and signals FRR to reload via frrinit.sh/watchfrr.

	  Provides full routing support (static routes, RIP, OSPF).

config BR2_PACKAGE_NETD_FRR_GRPC
	bool "FRR gRPC"
	depends on BR2_PACKAGE_FRR
	select BR2_PACKAGE_FRR_GRPC
	select BR2_PACKAGE_HOST_PROTOBUF
	help
	  Enable FRR integration via gRPC northbound API.
	  Provides full routing support (static routes, RIP, OSPF).

config BR2_PACKAGE_NETD_LINUX
	bool "Linux kernel"
	help
	  Use Linux kernel backend (rtnetlink) with static routes
	  only. No FRR dependency.

endchoice

endif
```

## package/nghttp2-asio/Config.in
```kconfig
config BR2_PACKAGE_NGHTTP2_ASIO
	bool "nghttp2-asio"
	depends on BR2_USE_MMU
	select BR2_PACKAGE_NGHTTP2
	select BR2_PACKAGE_BOOST
	help
	  C++ bindings for nghttp2

	  This is the CESNET fork of nghttp2-asio, introduced here:
	  https://github.com/CESNET/rousette/commit/fff3429

	  https://github.com/CESNET/nghttp2-asio
```
