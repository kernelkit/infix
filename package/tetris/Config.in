## package/tetris/Config.in
```kconfig
config BR2_PACKAGE_TETRIS
	bool "tetris - Micro Tetris"
	help
	  One of the smallest Tetris implementations in the world!

	  Utilizing only ANSI escape sequences to draw the board, no external
          library dependencies other than a standard C library, like uClibc or
          musl libc. Hence, very suitable for embedded devices in need of an
          easter egg ;-)

          https://troglobit.com/tetris.html
```

## package/umgmt/Config.in
```kconfig
config BR2_PACKAGE_UMGMT
	bool "umgmt"
	help
	  C library for user management on linux systems.

	  https://github.com/sartura/umgmt
```

## package/webui/Config.in
```kconfig
config BR2_PACKAGE_WEBUI
	bool "webui"
	depends on BR2_PACKAGE_HOST_GO_TARGET_ARCH_SUPPORTS
	depends on BR2_PACKAGE_ROUSETTE
	depends on !BR2_PACKAGE_LANDING
	help
	  Web management interface for Infix, a Go+HTMX application
	  that provides browser-based configuration and monitoring
	  via RESTCONF.
```

## package/wlan-support/Config.in
```kconfig
config BR2_PACKAGE_WLAN_SUPPORT
	bool "wlan-support"
	select BR2_PACKAGE_WPA_SUPPLICANT
	select BR2_PACKAGE_WPA_SUPPLICANT_WPA3
	select BR2_PACKAGE_WPA_SUPPLICANT_DEBUG_SYSLOG
	select BR2_PACKAGE_WPA_SUPPLICANT_CLI
	select BR2_PACKAGE_PYTHON_PYROUTE2
	select BR2_PACKAGE_LINUX_FIRMWARE
	select BR2_PACKAGE_BRCMFMAC_SDIO_FIRMWARE_RPI
	select BR2_PACKAGE_BRCMFMAC_SDIO_FIRMWARE_RPI_WIFI
	select BR2_PACKAGE_LINUX_FIRMWARE_RTL_RTW88
	select BR2_PACKAGE_LINUX_FIRMWARE_RTL_RTW89
	select BR2_PACKAGE_LINUX_FIRMWARE_BRCM_BCM43XX
	select BR2_PACKAGE_LINUX_FIRMWARE_BRCM_BCM4366B1
	select BR2_PACKAGE_LINUX_FIRMWARE_RTL_88XX

help
	  wlan-support enables all requried applications needed to run WLAN
          on Infix, some firmwares and some drivers.
```

## package/yangerd/Config.in
```kconfig
config BR2_PACKAGE_YANGERD
	bool "yangerd"
	depends on BR2_PACKAGE_HOST_GO_TARGET_ARCH_SUPPORTS
	help
	  Operational data daemon for YANG/NETCONF/RESTCONF.
	  Replaces Python yanger scripts with a persistent Go daemon
	  serving operational data over a Unix socket IPC protocol.
```

## qemu/Config.in
```kconfig
comment "System setup"

choice
	prompt "Loader"
	default QEMU_LOADER_KERNEL

config QEMU_LOADER_KERNEL
	bool "Kernel"

config QEMU_LOADER_UBOOT
	bool "U-Boot"
	depends on BR2_aarch64

config QEMU_LOADER_OVMF
	bool "OVMF (UEFI)"
	depends on BR2_x86_64

endchoice

choice
     prompt "Rootfs type"
     default QEMU_ROOTFS_INITRD

config QEMU_ROOTFS_MMC
     bool "MMC"

config QEMU_ROOTFS_INITRD
     bool "Initrd"

config QEMU_ROOTFS_VSCSI
     bool "Virtio SCSI"

endchoice

config QEMU_MACHINE
	string
	default "qemu-system-aarch64 -M virt -cpu cortex-a72 -m 256M"   if BR2_aarch64
	default "qemu-system-x86_64 -M q35,accel=kvm -cpu host -m 512M" if BR2_x86_64

config QEMU_KERNEL
	string
	depends on QEMU_LOADER_KERNEL
	default "images/Image"   if BR2_aarch64
	default "images/bzImage" if BR2_x86_64

config QEMU_BIOS
	string
	depends on !QEMU_LOADER_KERNEL
	default "images/u-boot.bin" if QEMU_LOADER_UBOOT
	default "images/OVMF.fd"    if QEMU_LOADER_OVMF

config QEMU_ROOTFS
	string
	default "images/disk.img"        if !QEMU_ROOTFS_INITRD
	default "images/rootfs.squashfs" if QEMU_ROOTFS_INITRD

config QEMU_CONSOLE
	string
	depends on !QEMU_ROOTFS_MMC
	default "ttyAMA0" if BR2_aarch64
	default "ttyS0"   if BR2_x86_64

config QEMU_DTB_EXTEND
	bool
	depends on QEMU_LOADER_UBOOT
	default y if BR2_aarch64

config QEMU_RW
	string "Writable /cfg layer"
	depends on QEMU_ROOTFS_INITRD
	default "images/cfg.ext4"

config QEMU_RW_VAR_OPT
	bool "Separate writable /var (256MB)"

if QEMU_RW_VAR_OPT

config QEMU_RW_VAR
	string "Writable /var layer"
	default "images/var.ext4"
endif

config QEMU_HOST
	string "Export host filesystem path"
	default "images"

config QEMU_APPEND
	string "Extra kernel options"
	depends on !QEMU_ROOTFS_MMC

config QEMU_EXTRA
	string "Extra QEMU options"

comment "Networking"

choice
     prompt "Mode"
     default QEMU_NET_USER

config QEMU_NET_NONE
     bool "None"

config QEMU_NET_BRIDGE
     bool "Bridged"

config QEMU_NET_USER
     bool "User"

config QEMU_NET_TAP
     bool "TAP"

endchoice

config QEMU_NET_MODEL
	string "Interface model"
	default "virtio"

config QEMU_NET_BRIDGE_DEV
	string "Bridge device"
	depends on QEMU_NET_BRIDGE
	default "virbr0"

config QEMU_NET_USER_OPTS
	string "User mode options"
	depends on QEMU_NET_USER
	help
	  Extra -nic user,<OPTIONS>

config QEMU_NET_TAP_N
	int "Number of TAPs"
	depends on QEMU_NET_TAP
	default 1
```
