## package/nginx-lua-module/Config.in
```kconfig
config BR2_PACKAGE_NGINX_LUA_MODULE
       bool "nginx-lua-module"
       select    BR2_PACKAGE_LUA_RESTY_CORE
       select    BR2_PACKAGE_LUA_RESTY_LRUCACHE
       depends on BR2_PACKAGE_NGINX_HTTP
       depends on BR2_PACKAGE_HAS_LUAINTERPRETER
	help
		Lua support in nginx
```

## package/onieprom/Config.in
```kconfig
menuconfig BR2_PACKAGE_ONIEPROM
	bool "onieprom"
	select BR2_PACKAGE_HOST_PYTHON3
	help
         ONIE EEPROM parser/generator

config BR2_PACKAGE_ONIEPROM_INSTALL_IMAGES
	bool "install onieprom in images"
	depends on BR2_PACKAGE_ONIEPROM
	default y
	help
         Install the onieprom script in the images direcory. Useful
         when the release is destined for someone who will have to
         create ONIE EEPROM binaries for deployment during
         manufacturing.
```

## package/osal/Config.in
```kconfig
config BR2_PACKAGE_OSAL
	bool "osal"
	depends on BR2_TOOLCHAIN_HAS_THREADS
	help
          This package contains an OS abstraction layer. The goal of
          the abstraction layer is to simplify writing software that
          runs on many platforms. This abstraction layer is mainly
          focused on threading functionality.

          https://github.com/rtlabs-com/osal

comment "osal needs a toolchain w/ threads"
	depends on !BR2_TOOLCHAIN_HAS_THREADS
```

## package/p-net/Config.in
```kconfig
menuconfig BR2_PACKAGE_P_NET
	bool "p-net"
	depends on BR2_PACKAGE_NETSNMP_SERVER
	select BR2_PACKAGE_OSAL
	help
          The rt-labs PROFINET stack p-net is used for PROFINET device
          implementations. It is easy to use and provides a small
          footprint. It is especially well suited for embedded systems
          where resources are limited and efficiency is crucial.

          It is written in C and can be run on bare-metal hardware, an
          RTOS such as rt-kernel, or on Linux or Windows. The main
          requirement is that the platform can send and receive RAW
          Ethernet Layer 2 frames. The p-net stack is supplied with
          full sources including a porting layer.

          https://github.com/rtlabs-com/p-net

if BR2_PACKAGE_P_NET

config BR2_PACKAGE_P_NET_MAX_SLOTS
	int "PNET_MAX_SLOTS"
	default 5
	help
	  Per API. Should be > 1 to allow at least one I/O module

config BR2_PACKAGE_P_NET_MAX_SUBSLOTS
	int "PNET_MAX_SUBSLOTS"
	default 3
	help
	  Per slot (DAP requires 2 + PNET_MAX_PHYSICAL_PORTS)

config BR2_PACKAGE_P_NET_MAX_PHYSICAL_PORTS
	int "PNET_MAX_PHYSICAL_PORTS"
	default 1
	help
	  Max number of physical ports

endif

comment "p-net needs the netsnmp server"
	depends on !BR2_PACKAGE_NETSNMP_SERVER
```

## package/podman/Config.in
```kconfig
config BR2_PACKAGE_PODMAN
	bool "podman"
	depends on BR2_PACKAGE_HOST_GO_TARGET_ARCH_SUPPORTS
	depends on BR2_PACKAGE_HOST_GO_TARGET_CGO_LINKING_SUPPORTS
	depends on BR2_TOOLCHAIN_HAS_THREADS
	depends on !BR2_TOOLCHAIN_USES_UCLIBC # no fexecve
	depends on BR2_USE_MMU # libgpgme
	select BR2_PACKAGE_CRUN # runtime dependency
	select BR2_PACKAGE_CONMON  # runtime dependency
	select BR2_PACKAGE_CNI_PLUGINS # runtime dependency
	select BR2_PACKAGE_BRIDGE_UTILS # Required for container networking
	select BR2_PACKAGE_IPTABLES # Required for container network
	select BR2_PACKAGE_CGROUPFS_MOUNT if !BR2_PACKAGE_SYSTEMD # runtime dependency
	select BR2_PACKAGE_CA_CERTIFICATES # Required for the podman pull command via https
	select BR2_PACKAGE_LIBGPGME
	help
	  podman is a CLI tool for spawning and running containers
	  according to the OCI specification.

	  https://github.com/containers/podman

if BR2_PACKAGE_PODMAN

config BR2_PACKAGE_PODMAN_DRIVER_BTRFS
	bool "btrfs filesystem driver"
	depends on BR2_USE_MMU # btrfs-progs
	depends on BR2_TOOLCHAIN_HAS_THREADS # btrfs-progs
	select BR2_PACKAGE_BTRFS_PROGS
	help
	  Build the btrfs filesystem driver.

config BR2_PACKAGE_PODMAN_DRIVER_DEVICEMAPPER
	bool "devicemapper filesystem driver"
	depends on BR2_TOOLCHAIN_HAS_THREADS # lvm2
	depends on BR2_USE_MMU # lvm2
	depends on !BR2_STATIC_LIBS # lvm2
	select BR2_PACKAGE_LVM2
	help
	  Build the devicemapper filesystem driver.

config BR2_PACKAGE_PODMAN_DRIVER_VFS
	bool "vfs filesystem driver"
	depends on BR2_USE_WCHAR # gvfs
	depends on BR2_USE_MMU # gvfs
	depends on BR2_TOOLCHAIN_HAS_THREADS # gvfs
	depends on !BR2_STATIC_LIBS # gvfs
	select BR2_PACKAGE_GVFS
	help
	  Build the vfs filesystem driver.

endif

comment "podman needs a glibc or musl toolchain w/ threads"
	depends on BR2_PACKAGE_HOST_GO_TARGET_ARCH_SUPPORTS && \
		BR2_PACKAGE_HOST_GO_TARGET_CGO_LINKING_SUPPORTS
	depends on !BR2_TOOLCHAIN_HAS_THREADS || BR2_TOOLCHAIN_USES_UCLIBC
```

## package/profeth/Config.in
```kconfig
config BR2_PACKAGE_PROFETH_SUPPORTED
	bool
	default y
       	depends on BR2_PACKAGE_P_NET
	depends on BR2_PACKAGE_NETSNMP_SERVER

config BR2_PACKAGE_PROFETH
	bool "profeth"
	depends on BR2_PACKAGE_PROFETH_SUPPORTED
	help
	  Simple profinet switch management.

	  Note: to run in Qemu you need the following menuconfig settings:
	        QEMU_NET_TAP=y
	        QEMU_NET_TAP_N=10

comment "profeth needs p-net"
	depends on !BR2_PACKAGE_PROFETH_SUPPORTED
```

## package/python-libyang/Config.in
```kconfig
config BR2_PACKAGE_PYTHON_LIBYANG
	bool "python-libyang"
	select BR2_PACKAGE_PYTHON_CFFI # runtime
	help
	  CFFI bindings to libyang.

	  https://github.com/CESNET/libyang-python
```

## package/python-libyang/Config.in.host
```kconfig
config BR2_PACKAGE_HOST_PYTHON_LIBYANG
	bool "host python-libyang"
	select BR2_PACKAGE_HOST_PYTHON_CFFI # runtime
	help
	  CFFI bindings to libyang.

	  https://github.com/CESNET/libyang-python
```

## package/python-spy/Config.in
```kconfig
config BR2_PACKAGE_PYTHON_SPY
	bool "python-spy"
	depends on BR2_aarch64 || BR2_x86_64
	select BR2_PACKAGE_PYTHON3
	help
	  Sampling profiler for Python programs.

	  https://github.com/benfred/py-spy
```

## package/python-statd/Config.in
```kconfig
config BR2_PACKAGE_PYTHON_STATD
	bool "python-statd"
	select BR2_PACKAGE_HOST_PYTHON3
	select BR2_PACKAGE_DBUS_PYTHON
	help
         Python helpers for statd.
```

## package/python-templating/Config.in
```kconfig
config BR2_PACKAGE_PYTHON_TEMPLATING
	bool "python-templating"
	help
	  This is the old version of the Mako templating library for Python.
	  It provides a familiar, non-XML syntax which compiles into Python
	  modules for maximum performance.

	  https://pypi.python.org/pypi/Mako
```

## package/python-yangdoc/Config.in
```kconfig
config BR2_PACKAGE_PYTHON_YANGDOC
	bool "python-yangdoc"
	select BR2_PACKAGE_PYTHON_LIBYANG #runtime
	help
	   YANG documentation viewer based on libyang, similar output to
	   that of pyang -f jstree.  The default output is a standalone
	   HTML file, called yangtree.html

           https://pypi.org/project/yangdoc/
```

## package/python-yangdoc/Config.in.host
```kconfig
config BR2_PACKAGE_HOST_PYTHON_YANGDOC
	bool "host python-yangdoc"
	select BR2_PACKAGE_HOST_PYTHON_LIBYANG #runtime
	help
	   YANG documentation viewer based on libyang, similar output to
	   that of pyang -f jstree.  The default output is a standalone
	   HTML file, called yangtree.html

           https://pypi.org/project/yangdoc/
```

## package/querierd/Config.in
```kconfig
config BR2_PACKAGE_QUERIERD
	bool "querierd"
	help
	  A bridge helper daemon for sending multicast queries.

	  https://github.com/westermo/querierd
```

## package/rauc-installation-status/Config.in
```kconfig
config BR2_PACKAGE_RAUC_INSTALLATION_STATUS
       bool rauc-installation-status
       help
	Simple tool to read the installation status and errors
	from rauc in a JSON format.

	https://github.com/kernelkit/infix
```

## package/rousette/Config.in
```kconfig
config BR2_PACKAGE_ROUSETTE
	bool "rousette"
	depends on BR2_USE_MMU
	select BR2_PACKAGE_BOOST
	select BR2_PACKAGE_BOOST_ATOMIC
	select BR2_PACKAGE_BOOST_THREAD
	select BR2_PACKAGE_BOOST_SYSTEM
	select BR2_PACKAGE_DOCOPT_CPP
	select BR2_PACKAGE_LIBYANG_CPP
	select BR2_PACKAGE_NGHTTP2
	select BR2_PACKAGE_NGHTTP2_ASIO
	select BR2_PACKAGE_SPDLOG
	select BR2_PACKAGE_SYSREPO_CPP
	help
	   RESTconf server
```

## package/show/Config.in
```kconfig
config BR2_PACKAGE_SHOW
	bool "show"
	help
	  Tool to retrieve and present operational data from sysrepo.

	  https://github.com/kernelkit/infix
```

## package/skeleton-init-finit/Config.in
```kconfig
config BR2_PACKAGE_SKELETON_INIT_FINIT
	bool
	select BR2_PACKAGE_HAS_SKELETON
	select BR2_PACKAGE_SKELETON_INIT_COMMON

config BR2_PACKAGE_PROVIDES_SKELETON
	default "skeleton-init-finit" if BR2_PACKAGE_SKELETON_INIT_FINIT

if BR2_PACKAGE_SKELETON_INIT_FINIT
menu "finit init skeleton"

config BR2_PACKAGE_SKELETON_INIT_FINIT_TELNETD
	bool "/etc/inetd.conf telnetd"
	help
	  Enable telnetd from inetd service (disabled).

endmenu
endif
```

## package/spacemit-k1-fsbl/fw_dynamic.its
```
/dts-v1/;

/ {
	description = "Configuration to load OpenSBI before U-Boot";
	#address-cells = <2>;
	fit,fdt-list = "of-list";

	images {
		opensbi {
			description = "OpenSBI fw_dynamic Firmware";
			type = "firmware";
			os = "opensbi";
			arch = "riscv";
			compression = "none";
			load = <0x0 0x0>;
			entry = <0x0 0x0>;
			data = /incbin/("./fw_dynamic.bin");
			hash-1 {
				algo = "crc32";
			};
		};
	};
	configurations {
		default = "config_1";

		config_1 {
			description = "opensbi FIT config";
			firmware = "opensbi";
		};
	};
};
```

## package/statd/Config.in
```kconfig
config BR2_PACKAGE_STATD
	bool "statd"
	select BR2_PACKAGE_JANSSON
	select BR2_PACKAGE_LIBEV
	select BR2_PACKAGE_SYSREPO
	help
	  Operational Status Daemon. Responsible for handling sysrepo
	  operational run-time info. Such as interface state and address.
	  All data supplied should be fetched from the running system,
	  which might differ from data configured through confd.
```

## package/sysrepo-cpp/Config.in
```kconfig
config BR2_PACKAGE_SYSREPO_CPP
	bool "sysrepo-cpp"
	depends on BR2_USE_MMU
	select BR2_PACKAGE_LIBYANG_CPP
	select BR2_PACKAGE_SYSREPO
	help
	   Sysrepo CPP bindings
```

## package/sysrepo-plugin-system/Config.in
```kconfig
config BR2_PACKAGE_SYSREPO_PLUGIN_SYSTEM
	bool "sysrepo-plugin-system"
	depends on BR2_USE_MMU
	depends on BR2_TOOLCHAIN_HAS_SYNC_4 # libyang
	depends on BR2_TOOLCHAIN_HAS_THREADS_NPTL
	select BR2_PACKAGE_LIBYANG
	select BR2_PACKAGE_SYSREPO
	select BR2_PACKAGE_SYSREPO_PLUGINS_COMMON
	select BR2_PACKAGE_UMGMT
	help
	  This Sysrepo plugin is based on the ietf-system YANG module
	  which provides "configuration and identification of some
	  common system properties within a device containing a NETCONF
	  server". More information about the specific YANG module can
	  be found in RFC 7317: A YANG Data Model for System Management.

	  https://github.com/telekom/sysrepo-plugin-system
```

## package/sysrepo-plugins-common/Config.in
```kconfig
config BR2_PACKAGE_SYSREPO_PLUGINS_COMMON
	bool "sysrepo-plugins-common"
	depends on BR2_USE_MMU
	depends on BR2_TOOLCHAIN_HAS_SYNC_4 # libyang
	depends on BR2_TOOLCHAIN_HAS_THREADS_NPTL
	select BR2_PACKAGE_LIBYANG
	select BR2_PACKAGE_SYSREPO
	help
	  Set of utilities/functionalities which can be used for easier build
	  of sysrepo plugins.

	  Used mainly by Deutsche Telekom sysrepo plugins:
	    - sysrepo-plugins-system
	    - sysrepo-plugins-interface

	  https://github.com/telekom/sysrepo-plugins-common
```

## package/sysrest/Config.in
```kconfig
config BR2_PACKAGE_SYSREST
	bool "sysrest"
	depends on BR2_PACKAGE_SYSREPO
	select BR2_PACKAGE_LIBCFGI
	help
	  RESTCONF front-end for Sysrepo
```

## package/test-mode/Config.in
```kconfig
config BR2_PACKAGE_TEST_MODE
	bool "test-mode"
	select BR2_PACKAGE_LIBITE
	select BR2_PACKAGE_LIBYANG
	select BR2_PACKAGE_SYSREPO
	select BR2_PACKAGE_LIBSRX
	select BR2_PACKAGE_CONFD
	help
	  A plugin to sysrepo that provides functionality required to
	  run tests with infamy.
```
