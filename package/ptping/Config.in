## package/ptping/Config.in
```kconfig
config BR2_PACKAGE_PTPING
	bool "ptping"
	help
	  Measure one-way latency across a network with PTP Sync
	  messages as probes, timestamped in hardware at both ends.
	  Probes can be sent within a window of a cyclic schedule, or
	  tagged by where in the cycle they left, to check an IEEE
	  802.1Qbv gate control list from a neighboring station.

	  https://github.com/wkz/ptping
```

## package/skopeo-target/Config.in
```kconfig
config BR2_PACKAGE_SKOPEO_TARGET
	bool "skopeo (target)"
	depends on BR2_PACKAGE_HOST_GO_TARGET_ARCH_SUPPORTS
	depends on BR2_PACKAGE_HOST_GO_TARGET_CGO_LINKING_SUPPORTS
	depends on BR2_TOOLCHAIN_HAS_THREADS
	select BR2_PACKAGE_CA_CERTIFICATES # registry TLS
	help
	  Copies container images between registries, archives and OCI
	  layouts.  Buildroot's skopeo package is host-only and Buildroot
	  does not allow a target variant added after it, hence the name.
	  Infix needs it on the target to pull images from registries.

	  https://github.com/containers/skopeo
```

## package/spacemit-k1-fsbl/Config.in
```kconfig
config BR2_PACKAGE_SPACEMIT_K1_FSBL
	bool "spacemit-k1-fsbl"
	depends on BR2_RISCV_64
	depends on BR2_TARGET_OPENSBI
	help
	  First stage bootloader for the SpacemiT K1, the vendor U-Boot
	  SPL with DDR init, signed for the BootROM.  Also wraps the
	  OpenSBI fw_dynamic.bin in the FIT image the FSBL loads from
	  the opensbi partition.

	  Installs FSBL.bin, bootinfo_sd.bin and fw_dynamic.itb.

	  https://gitee.com/spacemit-buildroot/uboot-2022.10
```

## package/support/Config.in
```kconfig
config BR2_PACKAGE_SUPPORT
	bool "support"
	help
	  The support tool collects logs, configuration and system state
	  into an archive for troubleshooting.  It is called from the CLI
	  and the infix-system:support-collect RPC, which the WebUI uses.

	  https://github.com/kernelkit/infix

if BR2_PACKAGE_SUPPORT

config BR2_PACKAGE_SUPPORT_ENCRYPT
	bool "Encrypted archives"
	depends on BR2_PACKAGE_GNUPG2_DEPENDS
	depends on !BR2_PACKAGE_GNUPG
	select BR2_PACKAGE_GNUPG2
	help
	  Allow a support archive to be encrypted with a password, using
	  GnuPG, before it leaves the device.  Adds gpg and its libraries
	  to the image.

endif
```

## package/symreg/Config.in
```kconfig
config BR2_PACKAGE_SYMREG
	bool "symreg - Microchip switch registers by name"
	depends on BR2_aarch64
	help
	  Read and write Microchip LAN969x switch registers by symbolic
	  name, and dump the MAC, VLAN, VCAP and stream tables, through
	  the symreg debugfs driver.  Debug aid, root only.  Selected by
	  the Laguna boards, see board/aarch64/microchip-lan969x/README.md

	  https://github.com/microchip-ung/symreg-tool
```
