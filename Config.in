## board/common/image/image-itb-qcow/Config.in
```kconfig
menuconfig IX_IMAGE_ITB_QCOW
	bool "QEMU disk image (ITB)"
	depends on (IX_IMAGE_ITB_ROOTFS && IX_IMAGE_ITB_AUX) || IX_IMAGE_ITB_DL_RELEASE
	select BR2_PACKAGE_HOST_GENIMAGE
	help
	  Compose a full disk image with redundant Linux OS partitions,
	  configuration partition, etc., for systems using ITB images.

	  This is useful when:
	  - Bringing up a blank system during manufacturing
	  - Creating a GNS3 appliance
	  - Developing/debugging issues in the boot process in QEMU

menuconfig IX_IMAGE_ITB_QCOW_SIZE
	string "Image size"
	depends on IX_IMAGE_ITB_QCOW
	default "512M"
	help
	  Create a disk image of this size.  A K/M/G suffix may be used
	  to multiply by powers of 1024.  Suffixes like KB/MB/GB may be
	  used to multiply by powers of 1000.  The image will be split
	  proportionally to fit the two rootfs, a kernel, a writable
	  /cfg and /var partiotions.

	  Minimum supported size is 512M.

choice
	prompt "Bootloader"
	depends on IX_IMAGE_ITB_QCOW
	default IX_IMAGE_ITB_QCOW_BOOT_EFI if BR2_x86_64
	default IX_IMAGE_ITB_QCOW_BOOT_NONE

config IX_IMAGE_ITB_QCOW_BOOT_NONE
	bool "None"
	help
	  Do not create any bootloader partition in the disk image.

config IX_IMAGE_ITB_QCOW_BOOT_EFI
	bool "EFI"
	help
	  Create a boot partition from a directory containing an EFI
	  boot application, e.g. GRUB.

config IX_IMAGE_ITB_QCOW_BOOT_BIN
	bool "Binary"
	help
	  Create a boot partition from a raw image containing the boot
	  application, e.g. U-Boot.

endchoice

config IX_IMAGE_ITB_QCOW_BOOT_DATA
	string "Bootloader data"
	depends on IX_IMAGE_ITB_QCOW
	depends on IX_IMAGE_ITB_QCOW_BOOT_EFI || IX_IMAGE_ITB_QCOW_BOOT_BIN
	default "${BINARIES_DIR}/efi-part/EFI" if BR2_x86_64
	help
	  Path to the directory or file holding the bootloader data.

config IX_IMAGE_ITB_QCOW_BOOT_OFFSET
	hex "Bootloader offset"
	depends on IX_IMAGE_ITB_QCOW
	depends on IX_IMAGE_ITB_QCOW_BOOT_EFI || IX_IMAGE_ITB_QCOW_BOOT_BIN
	default 0x8000
	help
	  Offset at which the bootloader partition is placed. Remember
	  to make sure that the GPT still fits at the start of the
	  image.
```

## board/common/image/image-lvm-stub/Config.in
```kconfig
config IX_IMAGE_LVM_STUB
	bool "LVM2 stub image"
	default y if IX_IMAGE_DDI
	depends on IX_IMAGE_BAREBOX_ESP
	help
	  A disk image with Barebox and an empty LVM2 physical volume
	  attached to the internal volume group. This is useful as a
	  base image for persistent storage in QEMU emulation
	  scenarios where the OS is supplied in a separate image.
```

## board/riscv64/Config.in
```kconfig
if BR2_RISCV_64

source "$BR2_EXTERNAL_INFIX_PATH/board/riscv64/bananapi-bpi-f3/Config.in"
source "$BR2_EXTERNAL_INFIX_PATH/board/riscv64/starfive-visionfive2/Config.in"

endif
```

## board/riscv64/bananapi-bpi-f3/Config.in
```kconfig
config BR2_PACKAGE_BANANAPI_BPI_F3
	bool "Banana Pi BPI-F3"
	depends on BR2_RISCV_64
	select SDCARD_AUX
	help
	  Support for the Banana Pi BPI-F3, based on the SpacemiT K1 SoC.
```

## board/riscv64/starfive-visionfive2/Config.in
```kconfig
config BR2_PACKAGE_STARFIVE_VISIONFIVE2
	bool "StarFive VisionFive2"
	depends on BR2_RISCV_64
	select SDCARD_AUX
	help
	  Support for the StarFive VisionFive2, based on the JH7110 SoC.
```

## board/x86_64/barebox_defconfig
```kconfig
CONFIG_NAME="efi_defconfig"
CONFIG_NVVAR=y
CONFIG_MMU=y
CONFIG_HUSH_FANCY_PROMPT=y
CONFIG_CMDLINE_EDITING=y
CONFIG_AUTO_COMPLETE=y
CONFIG_MENU=y
# CONFIG_TIMESTAMP is not set
CONFIG_BOOTM_SHOW_TYPE=y
CONFIG_BOOTM_VERBOSE=y
CONFIG_BOOTM_INITRD=y
CONFIG_BLSPEC=y
CONFIG_BOOT_DDI=y
CONFIG_FLEXIBLE_BOOTARGS=y
CONFIG_CONSOLE_ACTIVATE_ALL=y
CONFIG_PARTITION_DISK_EFI=y
# CONFIG_ENV_HANDLING is not set
CONFIG_DEFAULT_ENVIRONMENT=y
CONFIG_STATE=y
CONFIG_BOOTCHOOSER=y
CONFIG_RESET_SOURCE=y
CONFIG_DEFAULT_LOGLEVEL=4
CONFIG_DEBUG_LL=y
# CONFIG_EFI_HANDOVER_PROTOCOL is not set
CONFIG_EFI_PAYLOAD_BOOTM=y
CONFIG_EFI_PAYLOAD_STATE_LAYOUT_PATH="/env/state.dtb"
CONFIG_CMD_DMESG=y
CONFIG_LONGHELP=y
CONFIG_CMD_IOMEM=y
CONFIG_CMD_IMD=y
CONFIG_CMD_MEMINFO=y
CONFIG_CMD_BOOT=y
CONFIG_CMD_GO=y
CONFIG_CMD_LOADB=y
CONFIG_CMD_RESET=y
CONFIG_CMD_UIMAGE=y
CONFIG_CMD_BOOTCHOOSER=y
CONFIG_CMD_PARTITION=y
CONFIG_CMD_AUTOMOUNT=y
CONFIG_CMD_DMSETUP=y
CONFIG_CMD_VERITYSETUP=y
CONFIG_CMD_LVM=y
CONFIG_CMD_NV=y
CONFIG_CMD_EXPORT=y
CONFIG_CMD_GLOBAL=y
CONFIG_CMD_PRINTENV=y
CONFIG_CMD_MAGICVAR=y
CONFIG_CMD_MAGICVAR_HELP=y
CONFIG_CMD_BASENAME=y
CONFIG_CMD_DIRNAME=y
CONFIG_CMD_FILETYPE=y
CONFIG_CMD_LN=y
CONFIG_CMD_MD5SUM=y
CONFIG_CMD_READLINK=y
CONFIG_CMD_UNCOMPRESS=y
CONFIG_CMD_GETOPT=y
CONFIG_CMD_LET=y
CONFIG_CMD_MSLEEP=y
CONFIG_CMD_READF=y
CONFIG_CMD_SLEEP=y
CONFIG_CMD_DHCP=y
CONFIG_CMD_HOST=y
CONFIG_NET_CMD_IFUP=y
CONFIG_CMD_PING=y
CONFIG_CMD_TFTP=y
CONFIG_CMD_ECHO_E=y
CONFIG_CMD_EDIT=y
CONFIG_CMD_MENU=y
CONFIG_CMD_MENUTREE=y
CONFIG_CMD_READLINE=y
CONFIG_CMD_TIMEOUT=y
CONFIG_CMD_CRC=y
CONFIG_CMD_CRC_CMP=y
CONFIG_CMD_MM=y
CONFIG_CMD_DETECT=y
CONFIG_CMD_FLASH=y
CONFIG_CMD_POWEROFF=y
CONFIG_CMD_WD=y
CONFIG_CMD_KEYS=y
CONFIG_CMD_PKCS7=y
CONFIG_CMD_2048=y
CONFIG_CMD_BAREBOX_UPDATE=y
CONFIG_CMD_OF_DIFF=y
CONFIG_CMD_OF_NODE=y
CONFIG_CMD_OF_PROPERTY=y
CONFIG_CMD_OFTREE=y
CONFIG_CMD_TIME=y
CONFIG_NET=y
CONFIG_NET_NETCONSOLE=y
CONFIG_DEEP_PROBE_DEFAULT=y
CONFIG_OFDEVICE=y
CONFIG_DRIVER_SERIAL_EFI_STDIO=y
CONFIG_DRIVER_NET_EFI_SNP=y
# CONFIG_SPI is not set
CONFIG_DISK=y
CONFIG_DISK_WRITE=y
CONFIG_DM_BLK=y
CONFIG_DM_BLK_LINEAR=y
CONFIG_DM_BLK_VERITY=y
CONFIG_DM_LVM=y
CONFIG_USB_HOST=y
CONFIG_USB_EFI_IO_PROTOCOL=y
CONFIG_VIDEO=y
CONFIG_FRAMEBUFFER_CONSOLE=y
CONFIG_DRIVER_VIDEO_EFI_GOP=y
CONFIG_FINTEK_SUPERIO=y
CONFIG_SMSC_SUPERIO=y
CONFIG_WATCHDOG=y
CONFIG_WATCHDOG_EFI=y
CONFIG_F71808E_WDT=y
CONFIG_ITCO_WDT=y
# CONFIG_PINCTRL is not set
CONFIG_PCI_EFI=y
CONFIG_FS_EXT4=y
CONFIG_FS_TFTP=y
CONFIG_FS_TFTP_MAX_WINDOW_SIZE=128
CONFIG_FS_NFS=y
CONFIG_FS_EFI=y
CONFIG_FS_EFIVARFS=y
CONFIG_FS_FAT=y
CONFIG_FS_FAT_WRITE=y
CONFIG_FS_SQUASHFS=y
CONFIG_CRYPTO_RSA=y
CONFIG_CRYPTO_ECDSA=y
CONFIG_CRYPTO_EFI_DB=y
CONFIG_ZLIB=y
```

## configs/bpi_f3_boot_defconfig
```kconfig
BR2_riscv=y
BR2_TOOLCHAIN_EXTERNAL=y
BR2_DL_DIR="$(BR2_EXTERNAL_INFIX_PATH)/dl"
BR2_CCACHE=y
BR2_CCACHE_DIR="$(BR2_EXTERNAL_INFIX_PATH)/.ccache"
BR2_ENABLE_DEBUG=y
BR2_PACKAGE_OVERRIDE_FILE="$(BR2_EXTERNAL_INFIX_PATH)/local.mk"
BR2_GLOBAL_PATCH_DIR="$(BR2_EXTERNAL_INFIX_PATH)/patches"
BR2_SSP_NONE=y
BR2_INIT_NONE=y
BR2_SYSTEM_BIN_SH_NONE=y
# BR2_TARGET_ROOTFS_TAR is not set
BR2_TARGET_OPENSBI=y
BR2_TARGET_OPENSBI_CUSTOM_VERSION=y
BR2_TARGET_OPENSBI_CUSTOM_VERSION_VALUE="1.8.1"
BR2_TARGET_OPENSBI_PLAT="generic"
# BR2_TARGET_OPENSBI_INSTALL_JUMP_IMG is not set
BR2_TARGET_UBOOT=y
BR2_TARGET_UBOOT_BUILD_SYSTEM_KCONFIG=y
BR2_TARGET_UBOOT_CUSTOM_GIT=y
BR2_TARGET_UBOOT_CUSTOM_REPO_URL="https://github.com/kernelkit/u-boot.git"
BR2_TARGET_UBOOT_CUSTOM_REPO_VERSION="bee4e853602705860b5be3ab74fc7d65ddac69d6"
BR2_TARGET_UBOOT_BOARD_DEFCONFIG="spacemit_k1"
BR2_TARGET_UBOOT_CONFIG_FRAGMENT_FILES="$(BR2_EXTERNAL_INFIX_PATH)/board/common/uboot/extras.config $(BR2_EXTERNAL_INFIX_PATH)/board/riscv64/bananapi-bpi-f3/uboot/extras.config"
BR2_TARGET_UBOOT_NEEDS_DTC=y
BR2_TARGET_UBOOT_NEEDS_PYLIBFDT=y
BR2_TARGET_UBOOT_NEEDS_OPENSSL=y
BR2_TARGET_UBOOT_NEEDS_OPENSBI=y
# BR2_TARGET_UBOOT_FORMAT_BIN is not set
BR2_TARGET_UBOOT_FORMAT_CUSTOM=y
BR2_TARGET_UBOOT_FORMAT_CUSTOM_NAME="u-boot.itb"
BR2_TARGET_UBOOT_CUSTOM_DTS_PATH="$(BR2_EXTERNAL_INFIX_PATH)/board/riscv64/bananapi-bpi-f3/uboot/bpi-f3-env.dtsi"
BR2_PACKAGE_HOST_BMAP_TOOLS=y
BR2_PACKAGE_HOST_GENIMAGE=y
BR2_PACKAGE_HOST_RAUC=y
BR2_PACKAGE_HOST_UBOOT_TOOLS=y
BR2_PACKAGE_HOST_UBOOT_TOOLS_FIT_SUPPORT=y
BR2_PACKAGE_HOST_UBOOT_TOOLS_FIT_SIGNATURE_SUPPORT=y
BR2_PACKAGE_HOST_UBOOT_TOOLS_FDT_ADD_PUBKEY=y
BR2_PACKAGE_SPACEMIT_K1_FSBL=y
IX_TRUSTED_KEYS=y
IX_TRUSTED_KEYS_DEVELOPMENT=y
```

## configs/visionfive2_boot_defconfig
```kconfig
BR2_riscv=y
BR2_TOOLCHAIN_EXTERNAL=y
BR2_DL_DIR="$(BR2_EXTERNAL_INFIX_PATH)/dl"
BR2_CCACHE=y
BR2_CCACHE_DIR="$(BR2_EXTERNAL_INFIX_PATH)/.ccache"
BR2_ENABLE_DEBUG=y
BR2_PACKAGE_OVERRIDE_FILE="$(BR2_EXTERNAL_INFIX_PATH)/local.mk"
BR2_GLOBAL_PATCH_DIR="$(BR2_EXTERNAL_INFIX_PATH)/patches"
BR2_SSP_NONE=y
BR2_INIT_NONE=y
BR2_SYSTEM_BIN_SH_NONE=y
# BR2_TARGET_ROOTFS_TAR is not set
BR2_TARGET_OPENSBI=y
BR2_TARGET_OPENSBI_CUSTOM_VERSION=y
BR2_TARGET_OPENSBI_CUSTOM_VERSION_VALUE="1.4"
BR2_TARGET_OPENSBI_PLAT="generic"
# BR2_TARGET_OPENSBI_INSTALL_JUMP_IMG is not set
BR2_TARGET_OPENSBI_ADDITIONAL_VARIABLES="FW_TEXT_START=0x40000000 FW_OPTIONS=0"
BR2_TARGET_UBOOT=y
BR2_TARGET_UBOOT_BUILD_SYSTEM_KCONFIG=y
BR2_TARGET_UBOOT_CUSTOM_VERSION=y
BR2_TARGET_UBOOT_CUSTOM_VERSION_VALUE="2024.07"
BR2_TARGET_UBOOT_BOARD_DEFCONFIG="starfive_visionfive2"
BR2_TARGET_UBOOT_CONFIG_FRAGMENT_FILES="$(BR2_EXTERNAL_INFIX_PATH)/board/common/uboot/extras.config $(BR2_EXTERNAL_INFIX_PATH)/board/riscv64/starfive-visionfive2/uboot/extras.config"
BR2_TARGET_UBOOT_NEEDS_DTC=y
BR2_TARGET_UBOOT_NEEDS_PYLIBFDT=y
BR2_TARGET_UBOOT_NEEDS_OPENSSL=y
BR2_TARGET_UBOOT_NEEDS_OPENSBI=y
# BR2_TARGET_UBOOT_FORMAT_BIN is not set
BR2_TARGET_UBOOT_FORMAT_DTB=y
BR2_TARGET_UBOOT_FORMAT_CUSTOM=y
BR2_TARGET_UBOOT_FORMAT_CUSTOM_NAME="u-boot.itb"
BR2_TARGET_UBOOT_SPL=y
BR2_TARGET_UBOOT_SPL_NAME="spl/u-boot-spl.bin.normal.out"
BR2_TARGET_UBOOT_CUSTOM_DTS_PATH="$(BR2_EXTERNAL_INFIX_PATH)/board/riscv64/starfive-visionfive2/uboot/visionfive2-env.dtsi"
BR2_PACKAGE_HOST_BMAP_TOOLS=y
BR2_PACKAGE_HOST_GENIMAGE=y
BR2_PACKAGE_HOST_RAUC=y
BR2_PACKAGE_HOST_UBOOT_TOOLS=y
BR2_PACKAGE_HOST_UBOOT_TOOLS_FIT_SUPPORT=y
BR2_PACKAGE_HOST_UBOOT_TOOLS_FIT_SIGNATURE_SUPPORT=y
BR2_PACKAGE_HOST_UBOOT_TOOLS_FDT_ADD_PUBKEY=y
IX_TRUSTED_KEYS=y
IX_TRUSTED_KEYS_DEVELOPMENT=y
```

## package/feature-modem/Config.in
```kconfig
config BR2_PACKAGE_FEATURE_MODEM
	bool "Feature Modem"
	select BR2_PACKAGE_MODEMD
	select BR2_PACKAGE_MODEM_MANAGER
	select BR2_PACKAGE_MODEM_MANAGER_ATVIADBUS
	select BR2_PACKAGE_MODEM_MANAGER_LIBMBIM
	select BR2_PACKAGE_MODEM_MANAGER_LIBQMI
	select BR2_PACKAGE_MODEM_MANAGER_LIBQRTR
	help
	  Enables cellular modem support via ModemManager and the
	  modemd management daemon.  Includes drivers for common
	  USB option modems and QMI/MBIM-based devices.

	  ATVIADBUS allows raw AT commands over D-Bus (used by modemd to
	  enable GPS NMEA output via vendor-specific AT commands such as
	  AT+QGPS=1) without needing to start ModemManager in --debug
	  mode.

config BR2_PACKAGE_FEATURE_MODEM_QUALCOMM
	bool "Qualcomm-based modems (QMI/QRTR/MHI)"
	depends on BR2_PACKAGE_FEATURE_MODEM
	help
	  Adds kernel support for Qualcomm-based cellular modems that use
	  the MHI bus and QRTR IPC router (e.g. Sierra Wireless EM7xxx,
	  Quectel EM/RMxxx, Telit LN9xx).

config BR2_PACKAGE_FEATURE_MODEM_VIRTUAL
	bool "Virtual modem (dummy_hcd + AT emulator)"
	depends on BR2_PACKAGE_FEATURE_MODEM
	help
	  A virtual USB modem for the QEMU test target, to exercise the
	  modem support without modem hardware.  A USB gadget with one ACM
	  function on dummy_hcd shows up as an AT modem on ttyACM, served by
	  an AT command emulator; data calls run as PPP to a pppd in its own
	  network namespace.  Created at boot only on nodes the topology
	  gives a modem, see the opt/modem fw_cfg.

	  Leave disabled on real hardware; it only provides a simulated modem.
```

## package/feature-tsn/Config.in
```kconfig
config BR2_PACKAGE_FEATURE_TSN
	bool "Feature TSN"
	help
	  Time-sensitive networking shapers on switch ports: the IEEE
	  802.1Qav credit-based shaper and the IEEE 802.1Qbv time-aware
	  shaper, modelled by the IEEE 802.1DC interface modules.  Select
	  on products whose switch driver offloads the cbs and taprio
	  queueing disciplines.
```

## package/ixcont/Config.in
```kconfig
config BR2_PACKAGE_IXCONT
	bool "ixcont"
	select BR2_PACKAGE_CRUN
	select BR2_PACKAGE_IPROUTE2
	select BR2_PACKAGE_NFTABLES
	select BR2_PACKAGE_PYTHON3
	select BR2_PACKAGE_PYTHON3_ZLIB
	select BR2_PACKAGE_SKOPEO_TARGET
	help
	  Infix container runtime: runs OCI images with crun directly from
	  the read-only rootfs, supervised by Finit.  Replaces podman.
```

## package/libudev-zero/Config.in
```kconfig
config BR2_PACKAGE_LIBUDEV_ZERO
	bool "libudev-zero"
	select BR2_PACKAGE_HAS_UDEV
	help
	  Daemonless replacement for libudev.  Provides libudev.so.1 with
	  the same ABI as upstream systemd-udev / eudev, but reads device
	  properties directly from /sys and /run/udev/data/ without needing
	  a daemon.  Pairs naturally with finit-keventd, which produces the
	  /run/udev/data/ records and rebroadcasts kernel uevents on the
	  netlink group libudev-zero monitors.

	  https://github.com/illiliti/libudev-zero

if BR2_PACKAGE_LIBUDEV_ZERO

config BR2_PACKAGE_PROVIDES_UDEV
	default "libudev-zero"

endif
```

## package/mbedtls-atf/Config.in
```kconfig
config BR2_PACKAGE_MBEDTLS_ATF
	bool "mbedtls-atf"
	depends on BR2_TARGET_ARM_TRUSTED_FIRMWARE
	help
	  mbed TLS sources for Arm Trusted Firmware.

	  Platforms with Trusted Board Boot, e.g. Microchip LAN969x
	  (Laguna), authenticate each image in the FIP against a chain
	  of X.509 certificates.  ATF parses those with mbed TLS, which
	  it compiles into BL1 and BL2 from source, pointed out by the
	  MBEDTLS_DIR build variable.  Nothing is installed on target.

	  This is separate from the mbedtls package, which tracks the
	  3.x series for use as a library.  ATF 2.8 builds only against
	  the 2.28 LTS series, and expects sources, such as
	  library/rsa_internal.c, that 3.x no longer has.

	  https://www.trustedfirmware.org/projects/mbed-tls/
```
