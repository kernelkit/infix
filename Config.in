## Config.in
```kconfig
source "$BR2_EXTERNAL_INFIX_PATH/board/Config.in"

menu "Branding"

config IX_VENDOR
	string "Vendor name"
	default "KernelKit"
	help
	  The name of the operating system vendor. This is the name of the
	  organization or company which produces the OS.

	  This name is intended to be exposed in "About this system" UIs or
	  software update UIs when needed to distinguish the OS vendor from
	  the OS itself.  It is intended to be human readable.

	  Used for VENDOR_NAME in /etc/os-release and GNS3 appliance files.

config IX_VENDOR_HOME
	string "Vendor URL"
	help
	  The homepage of the OS vendor.  The value should be in RFC3986
	  format, and should be "http:" or "https:" URLs.  Only one URL shall
	  be listed in the setting.

	  Optional, used for VENDOR_HOME in /etc/os-release

config IX_NAME
	string "Operating system name"
	default "Infix"
	help
	  Mandatory.  Used for identifying the OS as NAME in /etc/os-release
	  and product_name in GNS3 appliance files.

config IX_ID
	string "Operating system identifier"
	default "infix"
	help
	  A lower-case string (no spaces or other characters outside of 0–9,
          a–z, '.', '_' and '-') identifying the operating system, excluding
          any version information and suitable for processing by scripts or
          usage in generated filenames.

	  Mandatory.  Used for identifying the OS as ID in /etc/os-release and
	  in the generated image name: ID-ARCH-VERSION.img

config IX_IMAGE_ID
	string "Operating system image name"
	default "${IX_ID}-${BR2_ARCH}"
	help
	  A lower-case string (no spaces or other characters outside of 0–9,
	  a–z, ".", "_" and "-"), for naming critical image files, directories
	  and archives containting the operating system.

	  Mandatory.  When INFIX_RELEASE is set, this string is appended to
	  the IMAGE_ID with a '-' separator.

config IX_COMPATIBLE
	string "Operating system compatible string"
	default "${IX_IMAGE_ID}"
	help
	  A lower-case string (no spaces or other characters outside of 0–9,
	  a–z, ".", "_" and "-"), used for image identification at upgrade.
	  E.g., the RAUC [system] compatible string.

	  Mandatory.  Defaults to $IX_IMAGE_ID, which in turn is composed
	  of $IX_ID-$BR2_ARCH.

config IX_TAGLINE
	string "Operating system tagline"
	default "Infix OS — Immutable.Friendly.Secure"
	help
	  Mandatory. Used for identifying the OS, e.g. as PRETTY_NAME in
	  /etc/os-release and description in the GNS3 appliance.

	  This is also show at boot when the system init process starts.

config IX_DESC
	string "Operating system description"
	help
	  Optional.  Used for long description texts about the OS.  E.g.,
	  the GNS3 appliance file description field.  Saved in the file
	  /etc/os-release as IX_DESC.

config IX_HOME
	string "Operating system URL"
	help
	  Used for identifying the OS, e.g. as HOME_URL in /etc/os-release

config IX_DOC
	string "Operating system docs"
	help
	  Optional.  Main documentation URL, will be shown in /etc/os-release
	  as DOCUMENTATION_URL.

config IX_SUPPORT
	string "Operating system support"
	help
	  Main support page for the operating system, if there is any.  This
	  is primarily intended for operating systems which vendors provide
	  support for.  May be a http:, https:, or mailto: URI.

	  Optional.  Shown, e.g., as SUPPORT_URL in /etc/os-release or
	  maintainer_email in .gns3a.

config IX_OEM_PATH
	string "Path to OEM br2-external"
	help
	  A br2-external using Infix will likely want to version the branded
	  OS using their own GIT tags.  Set this variable to point to the base
	  directory (absolute path) and the Infix post-build.sh will call `git
	  describe -C $IX_OEM_PATH`.

	  Note: the OS version (VERSION, VERSION_ID, BUILD_ID in
	  /etc/os-release) is always derived from `git describe`.  The global
	  variable INFIX_RELEASE does not change it; it only labels the release
	  channel (IMAGE_VERSION) and names the published artifacts.

endmenu

# For /etc/os-release, uses CondtionArchitechture= from systemd.unit(5)
config IX_ARCH
	string
	default "arm"     if BR2_arm
	default "arm64"   if BR2_aarch64
	default "mips64"  if BR2_mips64
	default "riscv64" if BR2_riscv
	default "x86_64"  if BR2_x86_64

source "$BR2_EXTERNAL_INFIX_PATH/package/Config.in"
source "$BR2_EXTERNAL_INFIX_PATH/package/Config.in.host"
source "$BR2_EXTERNAL_INFIX_PATH/board/common/Config.in"
```

## board/aarch64/bananapi-bpi-r2-pro/Config.in
```kconfig
config BR2_PACKAGE_BANANAPI_BPI_R2_PRO
	bool "Banana Pi R2 Pro"
	depends on BR2_aarch64
	select SDCARD_AUX
	select BR2_PACKAGE_INPUT_EVENT_DAEMON
	help
	  Build Banana PI R2 Pro support
```

## board/aarch64/microchip-ev23x71a/Config.in
```kconfig
config BR2_PACKAGE_MICROCHIP_EV23X71A
	bool "Microchip EV23X71A (Laguna)"
	depends on BR2_aarch64
	help
	  Support for the Microchip EV23X71A evaluation board, based on
	  the LAN969x (Laguna) family of TSN capable switches.  24 GbE
	  copper ports, 4 SFP+ ports, and a separate management port.
```

## board/aarch64/novarq-tactical-1000/Config.in
```kconfig
config BR2_PACKAGE_NOVARQ_TACTICAL_1000
	bool "Novarq Tactical 1000 (Laguna)"
	depends on BR2_aarch64
	help
	  Support for the Novarq Tactical 1000, based on the LAN969x
	  (Laguna) family of TSN capable switches.  24 GbE copper ports,
	  4 SFP+ ports, and a separate management port.
```

## board/arm/bananapi-bpi-m1/Config.in
```kconfig
config BR2_PACKAGE_BANANAPI_BPI_M1
	bool "Banana Pi BPI-M1"
	depends on BR2_arm
	select SDCARD_AUX
	select BR2_PACKAGE_INPUT_EVENT_DAEMON
	help
	  Support for the Banana Pi BPI-M1 single-board computer, the
	  first Banana Pi, with an Allwinner A20 dual-core Cortex-A7,
	  1 GiB DDR3, Gigabit Ethernet, SATA and an SD card slot.
```

## board/common/Config.in
```kconfig
menu "Images"

comment "DDI Based"
source "$BR2_EXTERNAL_INFIX_PATH/board/common/image/image-ddi/Config.in"
source "$BR2_EXTERNAL_INFIX_PATH/board/common/image/image-ddi-disk/Config.in"
source "$BR2_EXTERNAL_INFIX_PATH/board/common/image/image-ddi-rauc/Config.in"

comment "ITB Based"
source "$BR2_EXTERNAL_INFIX_PATH/board/common/image/image-itb-rootfs/Config.in"
source "$BR2_EXTERNAL_INFIX_PATH/board/common/image/image-itb-aux/Config.in"
source "$BR2_EXTERNAL_INFIX_PATH/board/common/image/image-itb-boot/Config.in"
source "$BR2_EXTERNAL_INFIX_PATH/board/common/image/image-itb-qcow/Config.in"
source "$BR2_EXTERNAL_INFIX_PATH/board/common/image/image-itb-gns3a/Config.in"
source "$BR2_EXTERNAL_INFIX_PATH/board/common/image/image-itb-rauc/Config.in"
source "$BR2_EXTERNAL_INFIX_PATH/board/common/image/image-ext4-rauc/Config.in"
source "$BR2_EXTERNAL_INFIX_PATH/board/common/image/image-itb-dl-release/Config.in"

comment "General"
source "$BR2_EXTERNAL_INFIX_PATH/board/common/image/image-barebox-esp/Config.in"
source "$BR2_EXTERNAL_INFIX_PATH/board/common/image/image-lvm-stub/Config.in"
source "$BR2_EXTERNAL_INFIX_PATH/board/common/image/image-readme/Config.in"

endmenu


menuconfig IX_KERNEL_SIGN
	bool "Sign Linux Kernel"
	default y if BR2_x86_64

config IX_KERNEL_SIGN_KEY
	string "signing key"
	depends on IX_KERNEL_SIGN
	default "${BR2_EXTERNAL_INFIX_PATH}/board/common/signing-keys/development/infix.key"
	help
	  Path to the private RSA key, in PKCS#8 format, used to sign
	  the kernel image.

config IX_KERNEL_SIGN_CERT
	string "signing cert"
	depends on IX_KERNEL_SIGN
	default "${BR2_EXTERNAL_INFIX_PATH}/board/common/signing-keys/development/infix.crt"
	help
	  Path to the X509 certificate whose associated public key can
	  validate the authenticity of the generated signature.


config IX_QEMU_SCRIPTS
	bool "QEMU scripts"
	default y
	help
	  Install QEMU scripts and related files in the images
	  directory, which can be used to launch virtual Infix
	  instances.

menuconfig IX_TRUSTED_KEYS
	bool "Trusted keys for image"
	help
	 Keys that will be accepted for this image

config IX_TRUSTED_KEYS_DEVELOPMENT
	bool "Development key"
	depends on IX_TRUSTED_KEYS

config IX_TRUSTED_KEYS_DEVELOPMENT_PATH
	string
	depends on IX_TRUSTED_KEYS_DEVELOPMENT
	default "${BR2_EXTERNAL_INFIX_PATH}/board/common/signing-keys/development/infix.crt"

config IX_TRUSTED_KEYS_EXTRA_PATH
	string "Path to extra keys to include in image"
	depends on IX_TRUSTED_KEYS
```

## board/common/image/image-barebox-esp/Config.in
```kconfig
menuconfig IX_IMAGE_BAREBOX_ESP
	bool "Barebox EFI System Partition"
	depends on BR2_TARGET_BAREBOX
	help
	  An EFI System Partition (ESP) with Barebox installed.

config IX_IMAGE_BAREBOX_ESP_KEY
	string "signing key"
	depends on IX_IMAGE_BAREBOX_ESP
	default "${BR2_EXTERNAL_INFIX_PATH}/board/common/signing-keys/development/infix.key"
	help
	  Path to the private RSA key, in PKCS#8 format, used to sign
	  the Barebox EFI payload.

config IX_IMAGE_BAREBOX_ESP_CERT
	string "signing cert"
	depends on IX_IMAGE_BAREBOX_ESP
	default "${BR2_EXTERNAL_INFIX_PATH}/board/common/signing-keys/development/infix.crt"
	help
	  Path to the X509 certificate whose associated public key can
	  validate the authenticity of the generated signature.
```

## board/common/image/image-ddi-disk/Config.in
```kconfig
menuconfig IX_IMAGE_DDI_DISK
	bool "LVM2 based provisioning disk (DDI)"
	depends on IX_IMAGE_DDI
	select IX_IMAGE_BAREBOX_ESP
	help
	  Compose a full disk image consisting of an EFI System
	  Partition (ESP) containing Barebox, and an LVM PV in which
	  Infix is installed as an LV.

config IX_IMAGE_DDI_DISK_QCOW_SIZE
	string "QEMU disk image size"
	depends on IX_IMAGE_DDI_DISK
	default "8G"
	help
	  Virtual size of the generated .qcow2.  The image is sparse,
	  so this does not affect the file size.  On first boot the
	  internal volume group is grown to fill the disk, and the
	  rw and secondary volumes are provisioned from that space.
	  The .disk image is not affected.
```

## board/common/image/image-ddi/Config.in
```kconfig
menuconfig IX_IMAGE_DDI
	bool "Discoverable Disk Image (DDI)"
	select BR2_TARGET_ROOTFS_SQUASHFS
	select BR2_PACKAGE_BTRFS_PROGS
	select BR2_PACKAGE_CRYPTSETUP
	select BR2_PACKAGE_GPTFDISK
	select BR2_PACKAGE_GPTFDISK_SGDISK
	select BR2_PACKAGE_LVM2
	select BR2_PACKAGE_MULTIPATH_TOOLS
	select BR2_PACKAGE_UTIL_LINUX_BINARIES
	select BR2_PACKAGE_HOST_GENIMAGE
	select BR2_PACKAGE_HOST_DRACUT
	help
	  Create a Discoverable Disk Image containing:
	  - SquashFS of the root filesystem
	  - dm-verity hash tree of the root filesystem
	  - DDI compliant JSON signature object of the hash tree

	  https://uapi-group.org/specifications/specs/discoverable_disk_image/

config IX_IMAGE_DDI_KEY
	string "signing key"
	depends on IX_IMAGE_DDI
	default "${BR2_EXTERNAL_INFIX_PATH}/board/common/signing-keys/development/infix.key"
	help
	  Path to the private RSA key, in PKCS#8 format, used to sign
	  the dm-verity hash tree.

config IX_IMAGE_DDI_CERT
	string "signing cert"
	depends on IX_IMAGE_DDI
	default "${BR2_EXTERNAL_INFIX_PATH}/board/common/signing-keys/development/infix.crt"
	help
	  Path to the X509 certificate whose associated public key can
	  validate the authenticity of the generated signature.

	  The SHA256 fingerprint of this certificate is recorded
	  alongside the standard PKCS#7 signature in the JSON object,
	  which can be useful to locate corresponding key on systems
	  that lack full X509 parsing capabilities.
```

## board/common/image/image-gns3a/Config.in
```kconfig
menuconfig IX_IMAGE_GNS3A
	bool "GNS3 Appliance"
	depends on BR2_x86_64
	depends on IX_IMAGE_DDI_DISK || IX_IMAGE_ITB_QCOW
	help
	  Create a GNS3 appliance description that, together with the
	  disk image, can be imported into GNS3.  The UEFI firmware is
	  the one from the GNS3 registry, GNS3 downloads it on import.

config IX_IMAGE_GNS3A_RAM
	int "Reserved RAM (MiB)"
	depends on IX_IMAGE_GNS3A
	default "512"
	help
	  Amount of host RAM reserved for an appliance instance.

config IX_IMAGE_GNS3A_IFNUM
	int "Number of interfaces"
	depends on IX_IMAGE_GNS3A
	default "10"
	help
	  Number of Ethernet interfaces to create for an appliance instance.
```

## board/common/image/image-itb-boot/Config.in
```kconfig
menuconfig IX_IMAGE_ITB_BOOT
	bool "boot.itb"
	depends on IX_IMAGE_ITB_ROOTFS
	select BR2_PACKAGE_HOST_UBOOT_TOOLS
	help
	  Create a FIT holding the kernel, the root filesystem, and every
	  device tree in the build, with one configuration per device
	  tree, so that a single U-Boot 'bootm <addr>#<board>' boots the
	  system on any board the build supports.

	  Infix normally netboots from rootfs.itb alone: the bootloader
	  maps the SquashFS inside it and runs sysboot, which reads the
	  kernel and device tree from /boot.  That require BLKMAP, SquashFS,
	  and sysboot, which vendor bootloaders rarely have enabled.  This
	  image a way around that.

	  Unsigned, unlike rootfs.itb: a bootloader that needs this image
	  cannot check a signature anyway, and the verified path stays
	  rootfs.itb by way of sysboot.

config IX_IMAGE_ITB_BOOT_DTB
	string "default device tree"
	depends on IX_IMAGE_ITB_BOOT
	default "microchip/lan9696-tactical-1000.dtb" if BR2_PACKAGE_NOVARQ_TACTICAL_1000
	help
	  The device tree behind the 'boot' configuration, which is the
	  one the boot script uses, as a path below /boot.  Every other
	  device tree in the build gets a configuration named after it.

config IX_IMAGE_ITB_BOOT_STRIP_KERNEL
	bool "leave the kernel out of the rootfs"
	depends on IX_IMAGE_ITB_BOOT
	default y
	help
	  The root filesystem carries a copy of the kernel in /boot for
	  the bootloaders that read it from there.  This image already
	  has the kernel, so drop that copy, about 13 MiB compressed.
	  Costs an unsquash and resquash of the rootfs on every build,
	  and means the booted rootfs is not byte for byte the one in
	  rootfs.itb.

config IX_IMAGE_ITB_BOOT_ADDR
	string "image load address"
	depends on IX_IMAGE_ITB_BOOT
	default "0x70000000" if BR2_PACKAGE_NOVARQ_TACTICAL_1000
	help
	  Where the boot script fetches the image to.  The only address
	  anywhere in this: the image itself carries none, so the same
	  image boots any board in the build, and this is what has to
	  suit the board the script is for.

config IX_IMAGE_ITB_BOOT_CONSOLE
	string "console"
	depends on IX_IMAGE_ITB_BOOT
	default "ttyAT0,115200" if BR2_PACKAGE_NOVARQ_TACTICAL_1000
	help
	  Console for the kernel command line in the boot script.
```

## board/common/image/image-itb-gns3a/Config.in
```kconfig
menuconfig IX_IMAGE_ITB_GNS3A
	bool "GNS3 Appliance (ITB)"
	depends on BR2_x86_64
	select IX_IMAGE_ITB_QCOW
	help
	  Create a GNS3 appliance description that, together with the
	  disk image, can be imported into GNS3.

config IX_IMAGE_ITB_GNS3A_RAM
	int "Reserved RAM (MiB)"
	depends on IX_IMAGE_ITB_GNS3A
	default "192"
	help
	  Amount of host RAM reserved for an appliance instance.

	  Minimum supported size is 192M.

config IX_IMAGE_ITB_GNS3A_IFNUM
	int "Number of interfaces"
	depends on IX_IMAGE_ITB_GNS3A
	default "1"
	help
	  Number of Ethernet interfaces to create for an appliance instance.
```
