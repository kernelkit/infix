/ {
	config {
		environment {
			boot_targets = "mmc1";
			ethprime = "eth1";

			/* This is a development platform, hard code developer mode */
			ixbtn-devmode = "setenv dev_mode yes; echo Enabled";
			ixbtn-factory = "echo \"No button available, use bootmenu\"";
		};
	};
};
