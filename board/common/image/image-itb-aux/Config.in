## board/common/image/image-itb-aux/Config.in
```kconfig
config IMAGE_ITB_AUX
	bool "aux partition"
	depends on IMAGE_ITB_ROOTFS
	select BR2_PACKAGE_HOST_UBOOT_TOOLS
	select BR2_PACKAGE_HOST_GENIMAGE
	help
	  Create and populate auxiliary partition, aux.ext4, with
	  metadata needed by U-Boot and RAUC to operate properly on
	  systems using ITB images. This may then be included as a
	  partition in a larger disk image.
```

## board/common/image/image-itb-dl-release/Config.in
```kconfig
menuconfig IMAGE_ITB_DL_RELEASE
	bool "Download existing release"
	depends on !BR2_TARGET_ROOTFS_SQUASHFS
	help
	  This is primarily used by target specific builds, where the
	  bootloader artifact needs to be combined with an existing
	  Infix image, to create a full disk image that can be
	  provisioned to an SD-card or eMMC.

config IMAGE_ITB_DL_RELEASE_URL
	string "URL"
	depends on IMAGE_ITB_DL_RELEASE
	default "https://github.com/kernelkit/infix/releases/download/latest/infix-${BR2_ARCH}.tar.gz"
	help
	  URL to release tarball.
```

## board/common/image/image-itb-rauc/Config.in
```kconfig
menuconfig IMAGE_ITB_RAUC
	bool "RAUC upgrade bundle (ITB)"
	select IMAGE_ITB_ROOTFS
	select BR2_PACKAGE_HOST_RAUC
	help
	  Create RAUC upgrade bundle, for targets using ITB images,
	  that can be used to upgrade a running system to this version
	  of Infix.

config IMAGE_ITB_RAUC_KEY
	string "signing key"
	depends on IMAGE_ITB_RAUC
	default "${BR2_EXTERNAL_INFIX_PATH}/board/common/signing-keys/development/infix.key"
	help
	  Path to the private key, in PKCS#8 format, used to sign
	  the RAUC bundle; or a PKCS#11 URI.

config IMAGE_ITB_RAUC_CERT
	string "signing certificate"
	depends on IMAGE_ITB_RAUC
	default "${BR2_EXTERNAL_INFIX_PATH}/board/common/signing-keys/development/infix.crt"
	help
	  Path to the X509 certificate which will be associated with
	  the bundle signature.

	  NOTE: This cert MUST be included in the trust store of the
	        system on which this bundle is to be installed.
```

## board/common/image/image-itb-rootfs/Config.in
```kconfig
menuconfig IMAGE_ITB_ROOTFS
	bool "rootfs.itb+.itbh"
	select BR2_TARGET_ROOTFS_SQUASHFS
	select BR2_PACKAGE_HOST_UBOOT_TOOLS
	help
	  Create a signed ITB image containing a SquashFS of rootfs
	  and extract detached header (.itbh) for U-Boot based
	  targets.

config IMAGE_ITB_ROOTFS_KEY
	string "signing key"
	depends on IMAGE_ITB_ROOTFS
	default "${BR2_EXTERNAL_INFIX_PATH}/board/common/signing-keys/development/infix.key"
	help
	  Path to the private RSA key, in PKCS#8 format, used to sign
	  the root filesystem.

	  If the path is prefixed with "<hint>:", then that used as
	  the "key-name-hint" in the resulting ITB, otherwise the
	  basename of the path, with any extension removed, is used.
```

## board/common/image/image-readme/Config.in
```kconfig
config IMAGE_README
	bool "Install README.md in images"
	help
	  Install a README.md with useful information about getting
	  started with Infix in the images directory (thereby also
	  including it in the resulting release tarball).
```

## board/common/qemu/Config.in
```kconfig
mainmenu "QEMU Virtualization"

choice
	prompt "Target Architecture"
	default QEMU_aarch64

config QEMU_x86_64
	bool "x86_64"
	select QEMU_ARCH_IS_64

config QEMU_aarch64
	bool "AArch64 (little endian)"
	select QEMU_ARCH_IS_64

endchoice

choice
	prompt "Loader"
	default QEMU_LOADER_KERNEL

config QEMU_LOADER_KERNEL
	bool "Kernel"

config QEMU_LOADER_UBOOT
	bool "U-Boot"
	depends on QEMU_aarch64

config QEMU_LOADER_OVMF
	bool "OVMF (UEFI)"
	depends on QEMU_x86_64

endchoice

choice
     prompt "Rootfs type"
     default QEMU_ROOTFS_INITRD

config QEMU_ROOTFS_MMC
     bool "MMC"
     depends on QEMU_aarch64

config QEMU_ROOTFS_INITRD
     bool "Initrd"
     depends on QEMU_LOADER_KERNEL

config QEMU_ROOTFS_VSCSI
     bool "Virtio SCSI"

endchoice

choice
     prompt "Console"
     default QEMU_CONSOLE_VIRTIO

config QEMU_CONSOLE_VIRTIO
     bool "Virtio (hvc0)"
     depends on QEMU_LOADER_KERNEL

config QEMU_CONSOLE_SERIAL
     bool "Serial (ttyS0/ttyAMA0)"

endchoice

config QEMU_MACHINE
	string
	default "qemu-system-aarch64 -M virt -cpu cortex-a72 -m 256M"   if QEMU_aarch64
	default "qemu-system-x86_64 -M q35,accel=kvm -cpu host -m 512M" if QEMU_x86_64

config QEMU_KERNEL
	string
	depends on QEMU_LOADER_KERNEL
	default "Image"   if QEMU_aarch64
	default "bzImage" if QEMU_x86_64

config QEMU_BIOS
	string
	depends on !QEMU_LOADER_KERNEL
	default "u-boot.bin" if QEMU_LOADER_UBOOT
	default "OVMF.fd"    if QEMU_LOADER_OVMF

config QEMU_ROOTFS
	string
	default "disk.img"        if !QEMU_ROOTFS_INITRD
	default "rootfs.squashfs" if QEMU_ROOTFS_INITRD

config QEMU_DTB_EXTEND
	bool
	depends on QEMU_LOADER_UBOOT
	default y if QEMU_aarch64

config QEMU_RW
	string "Writable /cfg layer"
	depends on QEMU_ROOTFS_INITRD
	default "cfg.ext4"

config QEMU_RW_VAR_OPT
	bool "Separate writable /var (256MB)"

if QEMU_RW_VAR_OPT

config QEMU_RW_VAR
	string "Writable /var layer"
	default "var.ext4"
endif

config QEMU_HOST
	string "Export host filesystem path"
	default "/tmp"

config QEMU_APPEND
	string "Extra kernel options"
	depends on !QEMU_ROOTFS_MMC

config QEMU_EXTRA
	string "Extra QEMU options"

comment "Networking"

choice
     prompt "Mode"
     default QEMU_NET_USER

config QEMU_NET_NONE
     bool "None"

config QEMU_NET_BRIDGE
     bool "Bridged"

config QEMU_NET_USER
     bool "User"

config QEMU_NET_TAP
     bool "TAP"

endchoice

config QEMU_NET_MODEL
	string "Interface model"
	default "virtio-net-pci"

config QEMU_NET_BRIDGE_DEV
	string "Bridge device"
	depends on QEMU_NET_BRIDGE
	default "virbr0"

config QEMU_NET_USER_OPTS
	string "User mode options"
	depends on QEMU_NET_USER
	help
	  Extra -nic user,<OPTIONS>

config QEMU_NET_TAP_N
	int "Number of TAPs"
	depends on QEMU_NET_TAP
	default 1
```

## board/common/rootfs.its
```
/dts-v1/;

/ {
	description = "Infix";
	creator = "infix";
	#address-cells = <0x1>;

	images {
		rootfs {
			description = "Infix";
			type = "ramdisk";
			os = "linux";
			compression = "none";
			data = /incbin/("rootfs.squashfs");
			signature-1 {
				algo = "sha256,rsa4096";
				key-name-hint = "infix";
			};
		};
	};

	configurations {
		default = "verity";
		verity {
			ramdisk = "rootfs";
		};
	};
};
```

## board/common/uboot/key-dummy.its
```
/dts-v1/;

/ {
	description = "dummy to convert keys in PEM format for inclusion in U-Boot's control DT";
	creator = "infix";
	#address-cells = <0x1>;

	images {
		ramdisk {
			description = "null";
			type = "ramdisk";
			os = "linux";
			compression = "none";
			data = /incbin/("/dev/null");

			signature-1 {
				algo = "sha256,rsa4096";
				key-name-hint = "infix";
			};
		};
	};

	configurations {};
};
```
