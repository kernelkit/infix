/ {
	config {
		env: environment {
		};
	};
};

&env {
	vendor = "infix";
	preboot = "run ixpreboot";
	ixbootdelay = "0.5";
	bootdelay = "-2";
	bootmenu_delay = "10";
	boot_targets = "virtio mmc";
	bootcmd = "run ixboot";

	ixpreboot     = /incbin/("scripts/ixpreboot.sh");
	ixbtn-devmode = /incbin/("scripts/ixbtn-devmode.sh");
	ixbtn-factory = /incbin/("scripts/ixbtn-factory.sh");
	ixfactory     = /incbin/("scripts/ixfactory.sh");

	ixboot      = /incbin/("scripts/ixboot.sh");
	ixbootslot  = /incbin/("scripts/ixbootslot.sh");
	ixprepblk   = /incbin/("scripts/ixprepblk.sh");
	ixprepdhcp  = /incbin/("scripts/ixprepdhcp.sh");
};
