## board/x86_64/Config.in
```kconfig
if BR2_x86_64

source "$BR2_EXTERNAL_INFIX_PATH/board/x86_64/sailfish-saline/Config.in"

endif
```

## board/x86_64/sailfish-saline/Config.in
```kconfig
config BR2_PACKAGE_SAILFISH_SALINE
	bool "Sailfish Saline"
	depends on BR2_x86_64
	select BR2_PACKAGE_FEATURE_TSN
	select BR2_PACKAGE_MODULES
	select BR2_PACKAGE_MODULES_PTP_PG210_PTP
	select BR2_PACKAGE_MODULES_NET_DSA_PASW
	select BR2_PACKAGE_MODULES_NET_DSA_PASW_TOOL
	select BR2_PACKAGE_MODULES_NET_ETH_XDMA_NET
	help
	  Saline board from Sailfish
```

## package/dhcprelayd/Config.in
```kconfig
config BR2_PACKAGE_DHCPRELAYD
	bool "dhcprelayd"
	select BR2_PACKAGE_LIBCONFUSE
	select BR2_PACKAGE_LIBEV
	select BR2_PACKAGE_NFTABLES # runtime, on bridge ports
	help
	  DHCP relay agent with option 82 support, for an IP address
	  per port on a switch.

	  https://github.com/kernelkit/dhcprelayd
```

## package/feature-pppoe/Config.in
```kconfig
config BR2_PACKAGE_FEATURE_PPPOE
	bool "Feature PPPoE client"
	select BR2_PACKAGE_PPPD
	help
	  Enables the PPPoE client, a PPP session over an Ethernet
	  interface to a broadband access server, with pppd and its
	  PPPoE plugin.
```

## package/ixcont/Config.in
```kconfig
config BR2_PACKAGE_IXCONT
	bool "ixcont"
	select BR2_PACKAGE_CRUN
	select BR2_PACKAGE_IPROUTE2
	select BR2_PACKAGE_PYTHON3
	select BR2_PACKAGE_PYTHON3_ZLIB
	select BR2_PACKAGE_SKOPEO_TARGET
	select BR2_PACKAGE_SQUASHFS
	help
	  Infix container runtime: runs SIF images with crun, read-only
	  straight from the image file, supervised by Finit.  OCI images
	  are converted to SIF.  Replaces podman.
```

## package/modules/Config.in
```kconfig
config BR2_PACKAGE_MODULES
	bool "modules"
	depends on BR2_LINUX_KERNEL
	help
	  External kernel modules

	  https://github.com/kernelkit/modules

if BR2_PACKAGE_MODULES

config BR2_PACKAGE_MODULES_PTP_PG210_PTP
	bool "AMD/Xilinx PG210 PTP Timer Syncer"
	help
	  PTP Hardware Clock (PHC) driver for AMDs Timer syncer block
	  in PG210.

config BR2_PACKAGE_MODULES_NET_DSA_PASW
	bool "Packet Architects FlexSwitch"
	select BR2_PACKAGE_HOST_PYTHON3
	select BR2_PACKAGE_HOST_PYTHON_PYYAML
	help
	  DSA driver for the FlexSwitch switch core from Packet
	  Architects.

config BR2_PACKAGE_MODULES_NET_DSA_PASW_TOOL
	bool "PASW debug tool"
	depends on BR2_PACKAGE_MODULES_NET_DSA_PASW
	select BR2_PACKAGE_PYTHON3
	help
	  Install debug tool to access switch registers via symbolic
	  names.

config BR2_PACKAGE_MODULES_NET_ETH_XDMA_NET
	bool "AMD/Xilinx XDMA netdevice"
	help
	  Netdevice for XDMA engines connected to AXI-S channels
	  carrying Ethernet frames.

endif
```

## package/webui/Config.in
```kconfig
config BR2_PACKAGE_WEBUI
	bool "webui"
	depends on BR2_PACKAGE_HOST_GO_TARGET_ARCH_SUPPORTS
	depends on BR2_PACKAGE_ROUSETTE
	depends on !BR2_PACKAGE_LANDING
	select BR2_PACKAGE_SUPPORT
	help
	  Web management interface for Infix, a Go+HTMX application
	  that provides browser-based configuration and monitoring
	  via RESTCONF.

config BR2_PACKAGE_NETBROWSE
	bool "netbrowse"
	depends on BR2_PACKAGE_WEBUI
	help
	  Browse mDNS hosts on your network from https://network.local

	  The browser is part of webui, this makes it available in the
	  web services configuration.
```
