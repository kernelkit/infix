#include <arm64/marvell/armada-3720-espressobin-v7-emmc.dts>

/ {
	chosen {
		infix {
			/* "admin" */
			factory-password-hash = "$5$mI/zpOAqZYKLC2WU$i7iPzZiIjOjrBF3NyftS9CCq8dfYwHwrmUK097Jca9A";
		};
	};
};
