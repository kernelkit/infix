/dts-v1/;
/plugin/;

&{/} {
	config {
		environment {
			vendor = "infix";
			preboot = "run ixpreboot";
			ixbootdelay = "0.5";
			bootdelay = "-2";
			bootmenu_delay = "10";
			boot_targets = "mmc1";
			ethprime = "eth0";
			bootcmd = "run ixboot";

			ixpreboot     = /incbin/("scripts/ixpreboot.sh");
			ixbtn-devmode = "setenv dev_mode yes; echo Enabled";
			ixbtn-factory = "echo \"No button available, use bootmenu\"";
			ixfactory     = /incbin/("scripts/ixfactory.sh");

			ixboot      = /incbin/("scripts/ixboot.sh");
			ixbootslot  = /incbin/("scripts/ixbootslot.sh");
			ixprepblk   = /incbin/("scripts/ixprepblk.sh");
			ixprepdhcp  = /incbin/("scripts/ixprepdhcp.sh");
		};
	};
};
