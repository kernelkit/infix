/* Factory EEPROM for PCIe MT7916 radio - Acer Connect Vero W */
/* Offset 0xa0000 in the "factory" GPT partition on eMMC */

&pcie_wifi {
	mediatek,eeprom-data = <
		 0x16790000 0x000c4326 0x60000000 0x00000000
		 0x00000000 0x00000000 0x00000000 0x00000000
		 0x00000000 0x00000000 0x00000000 0x00000000
		 0x50750000 0x07670700 0x00000400 0x50710000
		 0x00000000 0x00000400 0x00000000 0x00000000
		 0x00000000 0x00000000 0x00000000 0x00000000
		 0x00000000 0x00000000 0x00000000 0x00000000
		 0x00000000 0x00000000 0x00000000 0x00000000
		 0x00000000 0x00000000 0x00000000 0x00000000
		 0x00000000 0x00000000 0x00000000 0x00000000
		 0x00000000 0x00000000 0x00000000 0x00000000
		 0x00000000 0x00000000 0x00000000 0x00000000
		 0x00000000 0x00000000 0xb101e748 0xf57f5e99
		 0x00000000 0x00000000 0x00000000 0x00000000
		 0x00000000 0x00000000 0x00000000 0x00000000
		 0x00000000 0x00000000 0x00000000 0x00000000
		 0x00000000 0x00000800 0x00000000 0x00000000
		 0x00000000 0x00000000 0x00000000 0x00000000
		 0x00000000 0x00000000 0x00000000 0x00000000
		 0x00000000 0x00000000 0x00000000 0x00000000
		 0x00000000 0x00000000 0x00000000 0x00000000
		 0x00000000 0x00000000 0x00000000 0x00000000
		 0x00000000 0x00000000 0x00000000 0x00000000
		 0x00000000 0x00000000 0x00000000 0x00000000
		 0x00000000 0x00000000 0x00000000 0x00000000
 		 0x12924848 0x003e003f 0x3a100000 0x00000000
		 0x00000000 0x00000000 0x00000000 0x00000000
		 0x00000000 0x00000000 0x00000000 0x00000000
		 0x00000000 0x00000000 0x00000000 0x00000000
		 0x00000000 0x00000000 0x00000000 0x00000000
		 0x00000000 0x00000000 0x00000000 0x00000000
		 0x00000000 0x00000000 0x00000000 0x00000000
		 0x00000000 0x00000000 0x00000000 0x00000000
		 0x00000000 0x00000000 0x00000000 0x00000000
		 0x00000000 0x00000000 0x00000000 0x00000000
		 0x00000000 0x00000000 0x00000000 0x00000000
		 0x00000000 0x00000000 0x00000000 0x81a3a380
		 0xa4910091 0x00910091 0x00910000 0x00000000
		 0x00000000 0x00000000 0x00000000 0x00000000
		 0x000a0000 0x00000000 0x00000000 0x00000000
		 0x00000000 0x00000000 0x00000000 0x00000000
		 0x00000000 0x00000000 0x00000000 0x00000000
		 0x00000000 0x00000000 0x00000000 0x00000000
		 0x00000000 0x00000000 0x00000000 0x00000000
		 0x00000000 0x00000000 0x00000000 0x00000000
		 0x00000000 0x00000000 0x00000000 0x00000000
		 0x00000000 0x00000000 0x00000000 0x00000000
		 0x00000000 0x00000000 0x00000000 0x00000000
		 0x00000000 0x00000000 0x00000000 0x00000000
		 0x00000000 0x00000000 0x00000000 0x00000000
		 0x00000000 0x00000000 0x00000000 0x00000000
		 0x00000000 0x00000000 0x00000000 0x00000000
		 0x00000000 0x00000000 0x00000000 0x00000000
		 0x00000000 0x00000000 0x0000c500 0x00000000
		 0x00000000 0x00000000 0x00000000 0x00000000
		 0x00000000 0x00000000 0x00000000 0x00000000
		 0x00000000 0x00000000 0x00000000 0x00000000
		 0x00000000 0x00000000 0x00000000 0x00000000
		 0x00000000 0x00000000 0x00000000 0x00000000
		 0x00000000 0x00000000 0x00000000 0x00000000
		 0x00000000 0x00000000 0x00000000 0x00000000
		 0x00000000 0x00000000 0x00000000 0x00000000
		 0x00000000 0x00000013 0x12120000 0x00000000
		 0x00000000 0x00000303 0x03030303 0x03030303
		 0x03030303 0x03030505 0x05050505 0x05050505
		 0x05050505 0x05050000 0x001b1919 0x19181818
		 0x180f0006 0x1c0e080a 0x170e080a 0x170d0809
		 0x170d020a 0x0e0d020a 0x0e0d020a 0x0e0b020a
		 0x0e22222c 0x2c2b2b2b 0x2b2b2b2b 0x2b2b2b2b
		 0x2b2b2b2b 0x2b2b2b2b 0x2b000000 0x00000000
		 0x00000000 0x001e201e 0x201e2020 0x201e201e
		 0x20201e20 0x20272929 0x29272727 0x27272929
		 0x29272727 0x27000000 0x00000000 0x00000000
		 0x00000000 0x00cdcfcf 0xcfcfcf00 0x00000000
		 0x00000000 0x00000000 0x00000000 0x00000000
		 0x00000000 0x00000000 0x00000000 0x00000000
		 0x00000000 0x00000000 0x00000000 0x00000000
		 0x00000000 0x00000000 0x00000000 0x00000000
		 0x00000000 0x00000000 0x00000000 0x00000000
		 0x00000000 0x00000000 0x00000000 0x00000000
		 0x00000000 0x00000000 0x00000000 0x00000000
		 0x00000000 0x00000000 0x00000000 0x00000000
		 0x00000000 0x00000000 0x00000000 0x00000000
		 0x00000000 0x00000000 0x00000000 0x00000000
		 0x007f7f20 0x2530363c 0x41014347 0x4c52575c
		 0x7f7f0000 0x00000000 0x00000000 0x00000000
		 0x0000007f 0x7f252834 0x3c424a01 0x4d4f555f
		 0x636e7f7f 0x7f7f202a 0x303b444a 0x014d5158
		 0x5f666e7f 0x7f7f7f7f 0x8080c5c5 0xcbcbd9d9
		 0xe1e1ebeb 0x40408080 0xcfcfdbdb 0xe3e3efef
		 0xf7f74040 0x8080c1c1 0xcdcdd5d5 0xe1e1eded
		 0x40408080 0xbbbbc7c7 0xcfcfdbdb 0xe7e74040
		 0x00000000 0x00000000 0x00000000 0x00000000
		 0x00000000 0x00000000 0x00000000 0x00000000
		 0x00000000 0x00000000 0x00000000 0x00000000
		 0x00000000 0x00000000 0x00000000 0x00000000
		 0xb0900000 0x0000c0f0 0xf8000000 0x00000000
		 0x00000000 0x00000000 0x00000000 0x00000000
		 0x00000000 0x00000000 0x00000000 0x00000000
		 0x00000000 0x00000000 0x00000000 0x00000000
		 0x00000000 0x00000000 0x00000000 0x00000000
		 0x00000000 0x00000000 0x00000000 0x00000000
		 0x00000000 0x00000000 0x00000000 0x00000000
		 0x00000000 0x00000000 0x00000000 0x00000000
		 0x00000000 0x00000000 0x00000000 0x00000000
		 0x00000000 0x00000000 0x00000000 0x00000000
		 0x00000000 0x00000000 0x00000000 0x00000000
		 0x00000000 0x00000000 0x00000000 0x00000000
		 0x00000000 0x00000000 0x00000000 0x00000000
		 0x00000000 0x00000000 0x00000000 0x00000000
		 0x00000000 0x00000000 0x00000000 0x00000000
		 0x00000000 0x00000000 0x00000000 0x00000000
		 0x00000000 0x00000000 0x00000000 0x00000000
		 0x00000000 0x00000000 0x00000000 0x00000000
		 0x00000000 0x00000000 0x00000000 0x00000000
		 0x00000000 0x00000000 0x00000000 0x00000000
		 0x00000000 0x00000000 0x00000000 0x00000000
		 0x00000000 0x00000000 0x00000000 0x00000000
		 0x00000000 0x00000000 0x00000000 0x00000000
		 0x00000000 0x00000000 0x00000000 0x00000000
		 0x00000000 0x00000000 0x00000000 0x00000000
		 0x02000200 0x02000200 0x02000200 0x02000200
		 0x02000200 0x02000200 0x02000200 0x02000200
		 0x02000200 0x02000200 0x02000200 0x02000200
		 0x02000200 0x02000200 0x02000200 0x02000200
		 0x000000c6 0xc6c6c6c4 0x0000c5c5 0xc5c4c1c1
		 0x818383c3 0xc3c2c100 0x81848400 0xc5c5c4c1
		 0xc1818383 0x8585c3c3 0xc2c10081 0x84848686
		 0xc5c5c4c1 0xc1818383 0x8585c5c5 0xc4c1c181
		 0x83838585 0xc5c5c4c1 0xc1818383 0x8585c6c6
		 0xc4c300c6 0x00c6c4c3 0xc1008181 0xc6c6c4c3
		 0xc1008181 0x00c5c5c3 0xc2008182 0x8200c6c6
		 0xc4c3c100 0x81818686 0xc6c6c4c3 0xc1008181
		 0x8686c5c5 0xc3c20081 0x82828787 0xc5c5c3c2
		 0x00818282 0x8787c6c6 0xc4c3c100 0x81818686
		 0xc6c6c4c3 0xc1008181 0x8686c6c6 0xc4c3c100
		 0x81818686 0xc6c6c4c3 0x00c6c6c4 0xc3c10081
		 0x818686c6 0xc6c4c3c1 0x00818186 0x86c5c5c3
		 0xc2008182 0x828787c5 0xc5c3c281 0x82838388
		 0x88c6c6c4 0xc3c10081 0x818686c6 0xc6c4c3c1
		 0x00818186 0x86c6c6c4 0xc3c10081 0x81868600
		 0x00000000 0x00000000 0x00000000 0x00000000
		 0x00000000 0x00000000 0x00000000 0x00000000
		 0x00000000 0x00000000 0x00000000 0x00000000
		 0x00000000 0x00000000 0x00000000 0x00000000
		 0x00000000 0x00000000 0x00000000 0x00000000
		 0x00000000 0x00000000 0x00000000 0x00000000
		 0x00000000 0x00000000 0x00000000 0x00000000
		 0x00000000 0x00000000 0x00000000 0x00000000
		 0x00000000 0x00000000 0x00000000 0x00000000
		 0x00000000 0x00000000 0x00000000 0x00000000
		 0x00000000 0x00000000 0x00000000 0x00000000
		 0x00000000 0x00000000 0x00000000 0x00000000
		 0x00b70000 0x00b70000 0x00000000 0x00000000
		 0x01000000 0x0000c400 0xb8008700 0x00000000
		 0x00000000 0x00000000 0x00000000 0x00000000
		 0x00000000 0x00000000 0x00000000 0x00000000
		 0x00000000 0x00000000 0x00000000 0x00000000
		 0x00000000 0x00000000 0x00000000 0x00000000
		 0x00000000 0x00000000 0x00000000 0x00000000
		 0x00000000 0x00000000 0x00000000 0x00000000
		 0x00000000 0x00000000 0x00000000 0x00000000
		 0x00000000 0x00000000 0x00000000 0x00000000
		 0x00000000 0x00000000 0x00000000 0x00000000
		 0x00000000 0x00000000 0x00000000 0x00000000
		 0x00000000 0x00000000 0x00000000 0x00000000
		 0x00000000 0x00000000 0x00000000 0x00000000
		 0x00000000 0x00000000 0x00000000 0x00000000
		 0x00000000 0x00000000 0x00000000 0x00000000
		 0x00000000 0x00000000 0x00000000 0x00000000
		 0x00000000 0x00000000 0x00000000 0x00000000
		 0x00000000 0x00000000 0x00000000 0x00000000
		 0x00000000 0x00000000 0x00000000 0x00000000
		 0x00000000 0x00000000 0x00000000 0x00000000
		 0x00000000 0x00000000 0x00000000 0x00000000
		 0x00000000 0x00000000 0x00000000 0x00000000
		 0x00000000 0x00000000 0x00000000 0x00000000
		 0x00000000 0x00000000 0x00000000 0x00000000
		 0x00000000 0x00000000 0x00000000 0x00000000
		 0x00000000 0x00000000 0x00000000 0x00000000
		 0x00000000 0x00000000 0x00000000 0x00000000
		 0x00000000 0x00000000 0x00000000 0x00000000
		 0x00000000 0x00000000 0x00000000 0x00000000
		 0x00000000 0x00000000 0x00000000 0x00000000
		 0x00000000 0x00000000 0x00000000 0x00000000
		 0x00000000 0x00000000 0x00000000 0x00000000
		 0x00000000 0x00000000 0x00000000 0x00000000
		 0x00000000 0x00000000 0x00000000 0x00000000
		 0x00000000 0x00000000 0x00000000 0x00000000
		 0x00000000 0x00000000 0x00000000 0x00000000
		 0x00000000 0x00000000 0x00000000 0x00000000
		 0x00000000 0x00000000 0x00000000 0x00000000
		 0x00000000 0x00000000 0x00000000 0x00000000
		 0x00000000 0x00000000 0x00000000 0x00000000
		 0x00000000 0x00000000 0x00000000 0x00000000
		 0x00000000 0x00000000 0x00000000 0x00000000
		 0x00000000 0x00000000 0x00000000 0x00000000
		 0x00000000 0x00000000 0x00000000 0x00000000
		 0x00000000 0x00000000 0x00000000 0x00000000
		 0x00000000 0x00000000 0x00000000 0x00000000
		 0x00000000 0x00000000 0x00000000 0x00000000
		 0x00000000 0x00000000 0x00000000 0x00000000
		 0xc7c60000 0x89898987 0x87858381 0x898a8b8b
		 0x8a898785 0x88898988 0x87868584 0x00000000
		 0x00000000 0xcccfcecd 0xcdcacecd 0xcbcfcece
		 0xcfcfcfc7 0xcececdce 0xc7cfcec7 0xcfcfcfcf
		 0xcfcf0000 0x00000000 0x00000000 0x00000000
		 0x00000000 0x00000000 0x00000000 0x00000000
		 0x7fe2f0e4 0x00000000 0xa4de24df 0xa4e0a4e1
		 0xa4e1a4de 0x24dfa4e0 0xa4e1a4e1 0xa4dea4df
		 0xa4e0a4e1 0xa4e1a4de 0xa4df24e0 0xa4e1a4e1
		 0x00000000 0x00000000 0x00000000 0x00000000
		 0x00000000 0x00000000 0xde0fde0f 0xde0fde10
		 0xde11de11 0x5e12de12 0xde10de10 0xde10de11
		 0xde12de12 0xde13de13 0x5a085a09 0x5a0a5a0a
		 0x5a0a5a0a 0x5a0a5a0a 0x5a055a06 0x5a075a08
		 0x5a085a09 0x5a095a09 0x00000000 0x00000000
		 0x00000000 0x00000000 0x00000000 0x00000000
		 0x00000000 0x00000000 0x00000000 0x00000000
		 0x00000000 0x00000000 0x00000000 0x00ded453
		 0x00000000 0x00000000 0x00000000 0x00000000
		 0x00000000 0x00000000 0x00000000 0x00000000
		 0x00000000 0x00000000 0x00000000 0x00000000
		 0x00000000 0x00000000 0x00000000 0x00000000
		 0x00000000 0x00000000 0x00000000 0x00000000
		 0x00000000 0x00000000 0x00000000 0x00000000
		 0x00000000 0x00000000 0x00000000 0x00000000
		 0x00000000 0x00000000 0x00000000 0x00000000
		 0x00000000 0x00000000 0x00000000 0x00000000
		 0x00000000 0x00000000 0x00000000 0x00000000
		 0x00000000 0x00000000 0x00000000 0x00000000
		 0x00000000 0x00000000 0x00000000 0x00000000
		 0x00000000 0x00000000 0x00000000 0x00000000
		 0x00000000 0x00000000 0x00000000 0x00000000
		 0x00000000 0x00000000 0x00000000 0x00000000
		 0x00000000 0x00000000 0x00000000 0x00000000
		 0x00000000 0x00000000 0x00000000 0x00000000
		 0x00000000 0x00000000 0x00000000 0x00000000
		 0x00000000 0x00000000 0x00000000 0x00000000
		 0x00000000 0x00000000 0x00000000 0x00000000
		 0x00000000 0x00000000 0x00000000 0x00000000
		 0x00000000 0x00000000 0x00000000 0x00000000
		 0x00000000 0x00000000 0x00000000 0x00000000
		 0x00000000 0x00000000 0x00000000 0x00000000
		 0x00000000 0x00000000 0x00000000 0x00000000
		 0x00000000 0x00000000 0x00000000 0x00000000
		 0x00000000 0x00000000 0x00000000 0x00000000
		 0x00000000 0x00000000 0x00000000 0x00000000
		 0x00000000 0x00000000 0x00000000 0x00000000
		 0x00000000 0x00000000 0x00000000 0x00000000
		 0x00000000 0x00000000 0x00000000 0x00000000
		 0x00000000 0x00000000 0x00000000 0x00000000
		 0x00000000 0x00000000 0x00000000 0x00000000
		 0x00000000 0x00000000 0x00000000 0x00000000
		 0x00000000 0x00000000 0x00000000 0x00000000
		 0x00000000 0x00000000 0x00000000 0x00000000
	>;
};
