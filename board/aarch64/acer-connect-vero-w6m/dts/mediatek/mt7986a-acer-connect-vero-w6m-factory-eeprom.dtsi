/* Factory EEPROM for MT7976 WMAC (DBDC) - Acer Connect Vero W */
/* Band 1 patched from 5GHz-only to 5GHz+6GHz selectable */

&wifi {
	mediatek,eeprom-data = <
		 0x86790100 0x000c4326 0x60100000 0x00000000
		 0x00000000 0x00000000 0x00000000 0x00000000
		 0x00000000 0x00000000 0x00000000 0x00000000
		 0x00000000 0x00000000 0x00000000 0x00000000
		 0x00000000 0x00000000 0x00000000 0x00000000
		 0x00000000 0x00000000 0x00000000 0x01000000
		 0x00000000 0x00000000 0x00000000 0x00000000
		 0x00000000 0x00000000 0x00000000 0x00000000
		 0x00000000 0x00000000 0x00000000 0x00000000
		 0x00000000 0x00000000 0x00000000 0x00000000
		 0x00000000 0x00000000 0x00000000 0x00000000
		 0x00000000 0x00000000 0x00000000 0x00000000
		 0x00000000 0x00000000 0x00000000 0x00000000
		 0x00000000 0x00000000 0x00000000 0x00000000
		 0x00000000 0x00000000 0x00000000 0x00000000
		 0x00000000 0x00000000 0x00000000 0x00000000
		 0x00000000 0x00000800 0x00000000 0x00000000
		 0x00000000 0x00000000 0x00000000 0x00000000
		 0x00000000 0x00000000 0x00000000 0x00000000
		 0x00000000 0x00000000 0x00000000 0x00000000
		 0x00000000 0x00000000 0x00000000 0x00000000
		 0x00000000 0x00000000 0x00000000 0x00000000
		 0x00000000 0x00000000 0x00000000 0x00000000
		 0x00000000 0x00000000 0x00000000 0x00000000
		 0x00000000 0x00000000 0x00000000 0x00000000
 		 0x12525353 0x003c003f 0x3a100700 0x15030000
		 0x00000000 0x00000000 0x00000000 0x00000000
		 0x00000000 0x00000000 0x00000000 0x00000000
		 0x00000000 0x00000000 0x00000000 0x00000000
		 0x00000000 0x00000000 0x00000000 0x00000000
		 0x00000000 0x00000000 0x00000000 0x00000000
		 0x00000000 0x00000000 0x00000000 0x00000000
		 0x00000000 0x00000000 0x00000000 0x00000000
		 0x00000000 0x00000000 0x00000000 0x00000000
		 0x00000000 0x00000000 0x00000000 0x00000000
		 0x00000000 0x00000000 0x00000000 0x00000000
		 0x00000000 0x00000000 0x00000000 0x00000000
		 0x00000000 0x00000000 0x00000000 0x00000000
		 0x00000000 0x00000000 0x00000000 0x00000000
		 0x00000000 0x00000000 0x00000000 0x00000000
		 0x00000000 0x00000000 0x00000000 0x00000000
		 0x00000000 0x00000000 0x00000000 0x00000000
		 0x00000000 0x00000000 0x00000000 0x00000000
		 0x00000000 0x00000000 0x00000000 0x00000000
		 0x00000000 0x00000000 0x00000000 0x00000000
		 0x00000000 0x00000000 0x00000000 0x00000000
		 0x00000000 0x00000000 0x00000000 0x00000000
		 0x00000000 0x00000000 0x00000000 0x00000000
		 0x00000000 0x00000000 0x00000000 0x00000000
		 0x00000000 0x00000000 0x00000000 0x00000000
		 0x00000000 0x00000000 0x00000000 0x00000000
		 0x00000000 0x00000000 0x00000000 0x00000000
		 0x00000000 0x00000000 0x00000000 0x00000000
		 0x00000000 0x00000000 0x0000be00 0x00000000
		 0x0000c100 0x00000000 0x00000000 0xc3000000
		 0x00000000 0x00000000 0x00000000 0x00000000
		 0x00000000 0x00000000 0x00000000 0x00000000
		 0x00000000 0x00000000 0x00000000 0x00000000
		 0x00000000 0x00000000 0x00000000 0x00000000
		 0x00000000 0x00000000 0x00000000 0x00000000
		 0x00000000 0x00000000 0x00000000 0x00000000
		 0x00000000 0x00000000 0x00000000 0x00000000
		 0x00000000 0x00000009 0x00000000 0x00000000
		 0x00000000 0x00000303 0x03030303 0x03030303
		 0x03030303 0x03030303 0x03040303 0x03040303
		 0x03040303 0x03040000 0x00161b18 0x1b1a1a1a
		 0x1a0d0008 0x0f0d0209 0x0e0d0209 0x0e0d0209
		 0x0e0c020a 0x0e0c020a 0x0e0c020a 0x0e0b020b
		 0x0e2b2b2b 0x2b222222 0x22222222 0x22222222
		 0x22222222 0x22222222 0x22000000 0x00000000
		 0x00000000 0x002a2a2a 0x2a282828 0x282a2a2a
		 0x2a282828 0x282a2a2a 0x2a282828 0x282a2a2a
		 0x2a282828 0x28000000 0x00000000 0x00000000
		 0x00000000 0x00000000 0x00000000 0x00000000
		 0x00000000 0x00000000 0x00000000 0x00000000
		 0x00000000 0x00000000 0x00000000 0x00000000
		 0x00000000 0x00000000 0x00000000 0x00000000
		 0x00000000 0x00000000 0x00000000 0x00000000
		 0x00000000 0x00000000 0x00000000 0x00000000
		 0x00000000 0x00000000 0x00000000 0x00000000
		 0x00000000 0x00000000 0x00000000 0x00000000
		 0x00000000 0x00000000 0x00000000 0x00000000
		 0x00000000 0x00000000 0x00000000 0x00000000
		 0x00000000 0x00000000 0x00000000 0x00000000
		 0x007f7f20 0x2530363c 0x41014847 0x4c52575c
		 0x7f7f7f7f 0x1b222a33 0x3a40014d 0x464c525a
		 0x5e7f7f7f 0x7f252834 0x3c424a01 0x4a4f555d
		 0x636e7f7f 0x7f7f202a 0x303b444a 0x014a5158
		 0x5f666e7f 0x7f7f7f7f 0x8080c5c5 0xd1d1dddd
		 0xe5e5f3f3 0x40408080 0xcfcfdbdb 0xe3e3efef
		 0xf7f74040 0x8080bfbf 0xcbcbd9d9 0xe5e5eded
		 0x40408080 0xb9b9c5c5 0xd3d3dfdf 0xe7e74040
		 0x00000000 0x00000000 0x00000000 0x00000000
		 0x00000000 0x00000000 0x00000000 0x00000000
		 0x00000000 0x00000000 0x00000000 0x00000000
		 0x00000000 0x00000000 0x00000000 0x00000000
		 0xc0a0c0e0 0xfcfcafe0 0x00000000 0x00000000
		 0x00000000 0x00000000 0x00000000 0x00000000
		 0x00000000 0x00000000 0x00000000 0x00000000
		 0x00000000 0x00000000 0x00000000 0x00000000
		 0x00000000 0x00000000 0x00000000 0x00000000
		 0x00000000 0x00000000 0x00000000 0x00000000
		 0x00000000 0x00000000 0x00000000 0x00000000
		 0x00000000 0x00000000 0x00000000 0x00000000
		 0x00000000 0x00000000 0x00000000 0x00000000
		 0x00000000 0x00000000 0x00000000 0x00000000
		 0x00000000 0x00000000 0x00000000 0x00000000
		 0x00000000 0x00000000 0x00000000 0x00000000
		 0x00000000 0x00000000 0x00000000 0x00000000
		 0x00000000 0x00000000 0x00000000 0x00000000
		 0x00000000 0x00000000 0x00000000 0x00000000
		 0x00000000 0x00000000 0x00000000 0x00000000
		 0x00000000 0x00000000 0x00000000 0x00000000
		 0x00000000 0x00000000 0x00000000 0x00000000
		 0x00000000 0x00000000 0x00000000 0x00000000
		 0x00000000 0x00000000 0x00000000 0x00000000
		 0x00000000 0x00000000 0x00000000 0x00000000
		 0x00000000 0x00000000 0x00000000 0x00000000
		 0x00000000 0x00000000 0x00000000 0x00000000
		 0x00000000 0x00000000 0x00000000 0x00000000
		 0x00000000 0x00000000 0x00000000 0x00000000
		 0x02200220 0x02200220 0x02300230 0x02300230
		 0x02300230 0x02300230 0x02300230 0x02300230
		 0x02240224 0x02240224 0x02240224 0x02240224
		 0x02240224 0x02240224 0x02240224 0x02240224
		 0x000000c4 0xc4c4c4c4 0x0000c4c4 0xc4c4c1c1
		 0x008282c3 0xc3000000 0x00838300 0xc4c4c4c1
		 0xc1008282 0x8383c3c3 0xc2c10000 0x83838484
		 0xc4c4c4c1 0xc1008282 0x8383c4c4 0xc4c1c100
		 0x82828383 0xc4c4c4c1 0xc1008282 0x8383c4c4
		 0xc3c100c4 0x81c4c3c2 0x00818181 0xc4c4c3c2
		 0x00818282 0x00c4c4c2 0xc2008182 0x8200c4c4
		 0xc3c20081 0x82828484 0xc4c4c3c2 0x00818282
		 0x8484c4c4 0xc2c20081 0x82828484 0xc4c4c2c1
		 0x81828383 0x8585c4c4 0xc3c20081 0x82828484
		 0xc4c4c3c2 0x00818282 0x8484c4c4 0xc3c20081
		 0x82828484 0xc6c5c3c1 0x00c5c5c3 0xc2008182
		 0x828484c5 0xc5c3c200 0x81828284 0x84c4c4c3
		 0xc2008182 0x828484c4 0xc4c2c181 0x82838385
		 0x85c5c5c3 0xc2008182 0x828484c5 0xc5c3c200
		 0x81828284 0x84c5c5c3 0xc2008182 0x82848400
		 0x00000000 0x00000000 0x00000000 0x00000000
		 0x00000000 0x00000000 0x00000000 0x00000000
		 0x00000000 0x00000000 0x00000000 0x00000000
		 0x00000000 0x00000000 0x00000000 0x00000000
		 0x00000000 0x00000000 0x00000000 0x00000000
		 0x00000000 0x00000000 0x00000000 0x00000000
		 0x00000000 0x00000000 0x00000000 0x00000000
		 0x378a6e05 0x0ae64a6c 0x00000000 0x50050000
		 0x00000000 0x00000000 0x00000000 0x00000000
		 0x00000000 0x00000000 0x00000000 0x00000000
		 0x00000000 0x00000000 0x00000000 0x00000000
		 0x00000000 0x00000000 0x00000000 0x00000000
		 0x00b40000 0x00000000 0x00000000 0x00000000
		 0x00000000 0x00000000 0x00000000 0x00000000
		 0x00000000 0x00000000 0x00000000 0x00000000
		 0x00000000 0x00000000 0x00000000 0x00000000
		 0x00000000 0x00000000 0x00000000 0x00000000
		 0x00000000 0x00000000 0x00000000 0x00000000
		 0x00000000 0x00000000 0x00000000 0x00000000
		 0x00000000 0x00000000 0x00000000 0x00000000
		 0x00000000 0x00000000 0x00000000 0x00000000
		 0x00000000 0x00000000 0x00000000 0x00000000
		 0x00000000 0x00000000 0x00000000 0x00000000
		 0x00000000 0x00000000 0x00000000 0x00000000
		 0x00000000 0x00000000 0x00000000 0x00000000
		 0x00000000 0x00000000 0x00000000 0x00000000
		 0x00000000 0x00000000 0x00000000 0x00000000
		 0x00000000 0x00000000 0x00000000 0x00000000
		 0x00000000 0x00000000 0x00000000 0x00000000
		 0x00000000 0x00000000 0x00000000 0x00000000
		 0x00000000 0x00000000 0x00000000 0x00000000
		 0x00000000 0x00000000 0x00000000 0x00000000
		 0x00000000 0x00000000 0x00000000 0x00000000
		 0x00000000 0x00000000 0x00000000 0x00000000
		 0x00000000 0x00000000 0x00000000 0x00000000
		 0x00000000 0x00000000 0x00000000 0x00000000
		 0x00000000 0x00000000 0x00000000 0x00000000
		 0x00000000 0x00000000 0x00000000 0x00000000
		 0x00000000 0x00000000 0x00000000 0x00000000
		 0x00000000 0x00000000 0x00000000 0x00000000
		 0x00000000 0x00000000 0x00000000 0x00000000
		 0x00000000 0x00000000 0x00000000 0x00000000
		 0x00000000 0x00000000 0x00000000 0x00000000
		 0x00000000 0x00000000 0x00000000 0x00000000
		 0x00000000 0x00000000 0x00000000 0x00000000
		 0x00000000 0x00000000 0x00000000 0x00000000
		 0x00000000 0x00000000 0x00000000 0x00000000
		 0x00000000 0x00000000 0x00000000 0x00000000
		 0x00000000 0x00000000 0x00000000 0x00000000
		 0x00000000 0x00000000 0x00000000 0x00000000
		 0x00000000 0x00000000 0x00000000 0x00000000
		 0x00000000 0x00000000 0x00000000 0x00000000
		 0x00000000 0x00000000 0x00000000 0x00000000
		 0x00000000 0x00000000 0x00000000 0x00000000
		 0x00000000 0x00000000 0x00000000 0x00000000
		 0x00000000 0x00000000 0x00000000 0x00000000
		 0x00000000 0x00000000 0x00000000 0x00000000
		 0x00000000 0x00000000 0x00000000 0x00000000
		 0x00000000 0x00000000 0x00000000 0x00000000
		 0x00000000 0x00000000 0x00000000 0x00000000
		 0x00000000 0x00000000 0x00000000 0x00000000
		 0x86828786 0x87c8cb8a 0x8380c982 0x00c8ca86
		 0x8383c583 0x83c1c58c 0x8883c78b 0x8780c28c
		 0x8485c682 0xc3c4c4c4 0xc5c6c7c8 0xcfcecdcc
		 0xcccdcec1 0xc1c1c1c2 0xc4c6c7ce 0xcecfcfcf
		 0xcecec6c7 0xc8c9caca 0xcbcbd2d2 0xd2d2d0ce
		 0xcc8100c1 0xc3c5c6c7 0xc8d0d0d1 0xd1d1d0cf
		 0xdeee6be7 0x5fede2eb 0xce08ce09 0xce0ace0a
		 0x4e0b4f0b 0x4f0c4f0c 0x4f0d4f0d 0x540a540b
		 0x540c540b 0x540c510a 0x510b510c 0xd10c510d
		 0x00000000 0x00000000 0x00000000 0x00000000
		 0x00000000 0x00000000 0xde0fde10 0xde115e12
		 0xde12de12 0xde135e14 0x5e0cde0d 0xde0e5e10
		 0x5e105e10 0x5e11de11 0xde0ede0f 0xde10de11
		 0x5e12de12 0x5e135e13 0xde0f5e11 0x5e12de13
		 0x5e13de13 0xde14de14 0x00000000 0x00000000
		 0x00000000 0x00000000 0x00000000 0x00000000
		 0x00000000 0x00000000 0x00000000 0x00000000
		 0x00848484 0x84848484 0x84000000 0x00e4d5d4
		 0x00000000 0x00000000 0x00000000 0x00000000
		 0x00000000 0x00000000 0x00000000 0x00000000
		 0x00000000 0x00000000 0x00000000 0x00000000
		 0x00000000 0x00000000 0x00000000 0x00000000
		 0x00000000 0x00000000 0x00000000 0x00000000
		 0x00000000 0x00000000 0x00000000 0x00000000
		 0x00000000 0x00000000 0x00000000 0x00000000
		 0x00000000 0x00000000 0x00000000 0x00000000
		 0x00000000 0x00000000 0x00000000 0x00000000
		 0x00000000 0x00000000 0x00000000 0x00000000
		 0x00000000 0x00000000 0x00000000 0x00000000
		 0x00000000 0x00000000 0x00000000 0x00000000
		 0x00000000 0x00000000 0x00000000 0x00000000
		 0x00000000 0x00000000 0x00000000 0x00000000
		 0x00000000 0x00000000 0x00000000 0x00000000
		 0x00000000 0x00000000 0x00000000 0x00000000
		 0x00000000 0x00000000 0x00000000 0x00000000
		 0x00000000 0x00000000 0x00000000 0x00000000
		 0x00000000 0x00000000 0x00000000 0x00000000
		 0x00000000 0x00000000 0x00000000 0x00000000
		 0x00000000 0x00000000 0x00000000 0x00000000
		 0x00000000 0x00000000 0x00000000 0x00000000
		 0x00000000 0x00000000 0x00000000 0x00000000
		 0x00000000 0x00000000 0x00000000 0x00000000
		 0x00000000 0x00000000 0x00000000 0x00000000
		 0x00000000 0x00000000 0x00000000 0x00000000
		 0x00000000 0x00000000 0x00000000 0x00000000
		 0x00000000 0x00000000 0x00000000 0x00000000
		 0x00000000 0x00000000 0x00000000 0x00000000
		 0x00000000 0x00000000 0x00000000 0x00000000
		 0x00000000 0x00000000 0x00000000 0x00000000
		 0x00000000 0x00000000 0x00000000 0x00000000
		 0x00000000 0x00000000 0x00000000 0x00000000
		 0x00000000 0x00000000 0x00000000 0x00000000
		 0x00000000 0x00000000 0x00000000 0x00000000
		 0x00000000 0x00000000 0x00000000 0x00000000
	>;
};
