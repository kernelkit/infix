#include <arm64/rockchip/rk3328-nanopi-r2s.dts>
#include "infix.dtsi"

&{/chosen/infix} {
	/* Expose only the external USB 2.0 port for user management */
	usb-ports = <&usb_host0_ehci>;
	usb-port-names = "usb";
};
