// SPDX-License-Identifier: GPL-2.0
/*
 * Common Infix OS defaults
 */

/ {
	chosen {
		infix {
			/* Default admin user password: 'admin' */
			factory-password-hash = "$5$mI/zpOAqZYKLC2WU$i7iPzZiIjOjrBF3NyftS9CCq8dfYwHwrmUK097Jca9A";
			usb-ports = <&usb>;
			usb-port-names = "USB";
		};
	};
};
