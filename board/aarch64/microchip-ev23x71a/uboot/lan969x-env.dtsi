/*
 * Board environment, applied on top of the common Infix one.  DRAM
 * starts at 0x60000000, and the addresses mirror the layout used on
 * other Infix boards: the kernel is staged 64 MiB in, clear of where
 * booti relocates it to at the start of DRAM.
 */
/ {
	config {
		/*
		 * Name the partition holding the environment, rather than
		 * inheriting the offset from lan969x.dtsi, which points
		 * into the middle of the Infix layout.
		 */
		u-boot,mmc-env-partition = "Env";
	};
};

&env {
	bootcmd = "run ixboot";
	boot_targets = "mmc0";

	board   = "microchip,ev23x71a";
	fdtfile = "microchip/lan9696-ev23x71a.dtb";

	loadaddr          = "0x63000000";
	fdt_addr_r        = "0x63f00000";
	kernel_addr_r     = "0x64000000";
	fdtoverlay_addr_r = "0x67f00000";
	scriptaddr        = "0x68000000";
	ramdisk_addr_r    = "0x6a000000";

	/* This is a development board, keep developer mode enabled. */
	ixbtn-devmode = "setenv dev_mode yes; echo Enabled";

	/* No front panel button to hold, and no button command built. */
	ixbtn-factory = "echo Unavailable";
};
