## board/Config.in
```kconfig
menu "Board Support"

source "$BR2_EXTERNAL_INFIX_PATH/board/arm/Config.in"
source "$BR2_EXTERNAL_INFIX_PATH/board/aarch64/Config.in"
source "$BR2_EXTERNAL_INFIX_PATH/board/riscv64/Config.in"
source "$BR2_EXTERNAL_INFIX_PATH/board/x86_64/Config.in"

endmenu
```

## board/aarch32/Config.in
```kconfig
if BR2_arm

source "$BR2_EXTERNAL_INFIX_PATH/board/aarch32/raspberrypi-rpi2/Config.in"

endif
```

## board/aarch64/Config.in
```kconfig
if BR2_aarch64

source "$BR2_EXTERNAL_INFIX_PATH/board/aarch64/alder-alder/Config.in"
source "$BR2_EXTERNAL_INFIX_PATH/board/aarch64/bananapi-bpi-r3/Config.in"
source "$BR2_EXTERNAL_INFIX_PATH/board/aarch64/freescale-imx8mp-evk/Config.in"
source "$BR2_EXTERNAL_INFIX_PATH/board/aarch64/friendlyarm-nanopi-r2s/Config.in"
source "$BR2_EXTERNAL_INFIX_PATH/board/aarch64/marvell-cn9130-crb/Config.in"
source "$BR2_EXTERNAL_INFIX_PATH/board/aarch64/marvell-espressobin/Config.in"
source "$BR2_EXTERNAL_INFIX_PATH/board/aarch64/microchip-sparx5-pcb135/Config.in"
source "$BR2_EXTERNAL_INFIX_PATH/board/aarch64/raspberrypi-rpi64/Config.in"
source "$BR2_EXTERNAL_INFIX_PATH/board/aarch64/styx-dcp-sc-28p/Config.in"

endif
```

## board/aarch64/acer-connect-vero-w/Config.in
```kconfig
config BR2_PACKAGE_ACER_CONNECT_VERO_W6
	bool "Acer Connect Vero w6"
	depends on BR2_aarch64
	select BR2_PACKAGE_BANANAPI_BPI_R3
	help
	  Build Acer Connect Vero w6
```

## board/aarch64/acer-connect-vero-w6m/Config.in
```kconfig
config BR2_PACKAGE_ACER_CONNECT_VERO_W6M
	bool "Acer Connect Vero W6m"
	depends on BR2_aarch64
	select BR2_PACKAGE_BANANAPI_BPI_R3
	help
	  Build Acer Connect Vero W6m
```

## board/aarch64/alder-alder/Config.in
```kconfig
config BR2_PACKAGE_ALDER_ALDER
	bool "Alder"
	depends on BR2_aarch64
	select BR2_PACKAGE_LINUX_FIRMWARE_INSIDE_SECURE_MINIFW
	help
	  Alder
```

## board/aarch64/bananapi-bpi-r3/Config.in
```kconfig
config BR2_PACKAGE_BANANAPI_BPI_R3
	bool "Banana Pi R3"
	depends on BR2_aarch64
	select BR2_PACKAGE_FEATURE_WIFI
	select BR2_PACKAGE_LINUX_FIRMWARE
	select BR2_PACKAGE_LINUX_FIRMWARE_MEDIATEK
	select BR2_PACKAGE_LINUX_FIRMWARE_MEDIATEK_MT7986
	select SDCARD_AUX
	help
	  Build Banana PI R3 support
```

## board/aarch64/bananapi-bpi-r4/Config.in
```kconfig
config BR2_PACKAGE_BANANAPI_BPI_R4
	bool "Banana Pi R4"
	depends on BR2_aarch64
	select BR2_PACKAGE_FEATURE_WIFI
	select BR2_PACKAGE_LINUX_FIRMWARE
	select BR2_PACKAGE_LINUX_FIRMWARE_MEDIATEK
	select BR2_PACKAGE_LINUX_FIRMWARE_MEDIATEK_MT7988
	select BR2_PACKAGE_LINUX_FIRMWARE_MEDIATEK_MT7996
	select SDCARD_AUX
	help
	  Build Banana PI R4 support
```

## board/aarch64/bananapi-bpi-r64/Config.in
```kconfig
config BR2_PACKAGE_BANANAPI_BPI_R64
	bool "Banana Pi R64"
	depends on BR2_aarch64
	select BR2_PACKAGE_FEATURE_WIFI
	select SDCARD_AUX
	help
	  Build Banana PI R64 support
```

## board/aarch64/freescale-imx8mp-evk/Config.in
```kconfig
config BR2_PACKAGE_FREESCALE_IMX8MP_EVK
	bool "NXP i.MX8MP EVK"
	depends on BR2_aarch64
	help
	  NXP i.MX8MP EVK
```

## board/aarch64/friendlyarm-nanopi-r2s/Config.in
```kconfig
config BR2_PACKAGE_FRIENDLYARM_NANOPI_R2S
	bool "FriendlyElec NanoPi R2S"
	depends on BR2_aarch64
	select SDCARD_AUX
	select BR2_PACKAGE_INPUT_EVENT_DAEMON
	select BR2_PACKAGE_LINUX_FIRMWARE_RTL_815X
	select BR2_PACKAGE_INPUT_EVENT_DAEMON
	help
	  FriendlyElec NanoPi R2S is a compact router board based on
	  the Rockchip RK3328 SoC with dual Gigabit Ethernet ports.
```
