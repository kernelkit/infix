## board/arm/raspberrypi-rpi2/Config.in
```kconfig
config BR2_PACKAGE_RASPBERRYPI_RPI2
	bool "Raspberry Pi 2 Model B (32-bit ARMv7)"
	depends on BR2_arm
	select SDCARD_AUX
	help
	  Support for the 32-bit ARMv7 Raspberry Pi 2B single-board computer
	  (SBC) with BCM2836 quad-core Cortex-A7 processor.

	  This was the only Raspberry Pi model with the BCM2836 and the rare
	  RPi 2B board revision v1.2 actually got an underclocked BCM2837,
	  which is the saem Cortex-A53 as the RPi3, but w/o wifi.
```

## board/common/image/image-ddi-lvm/Config.in
```kconfig
menuconfig IMAGE_DDI_LVM
	bool "LVM2 based provisioning disk (DDI)"
	depends on IMAGE_DDI
	help
	  Compose a full disk image consisting of an EFI System
	  Partition (ESP) containing Barebox, and an LVM PV in which
	  Infix is installed as an LV.
```

## board/common/image/image-ext4-rauc/Config.in
```kconfig
config IMAGE_EXT4_RAUC
	bool "RAUC upgrade bundle (ext4)"
	depends on BR2_TARGET_ROOTFS_EXT2
	select BR2_PACKAGE_HOST_RAUC
	help
	  Create a RAUC upgrade bundle for targets using an ext4 rootfs
	  image.  Intended for development boards whose bootloader does
	  not support squashfs.

config IMAGE_EXT4_RAUC_KEY
	string "signing key"
	depends on IMAGE_EXT4_RAUC
	default "${BR2_EXTERNAL_INFIX_PATH}/board/common/signing-keys/development/infix.key"
	help
	  Path to the private key, in PKCS#8 format, used to sign
	  the RAUC bundle; or a PKCS#11 URI.

config IMAGE_EXT4_RAUC_CERT
	string "signing certificate"
	depends on IMAGE_EXT4_RAUC
	default "${BR2_EXTERNAL_INFIX_PATH}/board/common/signing-keys/development/infix.crt"
	help
	  Path to the X509 certificate which will be associated with
	  the bundle signature.

	  NOTE: This cert MUST be included in the trust store of the
	        system on which this bundle is to be installed.
```
